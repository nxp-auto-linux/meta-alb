## conf/distro/fsl-auto.conf
```bitbake
require conf/distro/poky.conf

DISTRO = "fsl-auto"
DISTRO_NAME = "Auto Linux BSP"
SDK_VENDOR = "-fslbsp"
MAINTAINER = "Catalin Dan Udma <catalin-dan.udma@nxp.com>"

TARGET_VENDOR = "-fsl"

SDK_NAME_PREFIX = "${DISTRO}"
SDK_NAME = "${DISTRO}-${TCLIBC}-${SDK_ARCH}-${TUNE_PKGARCH}"

POKY_DEFAULT_DISTRO_FEATURES:remove = " ptest"
DISTRO_FEATURES_DEFAULT:append = " benchmark vfat ext2 mtd \
    perl python security usbhost virtualization"

# disable network check to support offline build with sdk iso
CONNECTIVITY_CHECK_URIS = ""

# whiteliste restricted license
LICENSE_FLAGS_ACCEPTED = "non-commercial_netperf commercial_lame"

DISTRO_FEATURES_DEFAULT:append = " pam polkit"

# Given the layers we use, we have qemu and qemu-qoriq which are
# not yet synchronized into one. ALB historically has used qemu
# and all the necessary patches are there.
PREFERRED_PROVIDER_qemu = "qemu"

IMAGE_CLASSES += "image_types_fsl_flashimage image_types_fsl_sdcard image_types_fsl_itb"

# UBI FS support
MKUBIFS_ARGS = "-m 512 -e 15360 -c 12000"
UBINIZE_ARGS = "-m 512 -p 16KiB -s 512"

DISTRO_VERSION = "${@d.getVar('RELEASE_BASE').replace('release/','').replace('bsp','').replace('_','')}"

# Patch machine configs from other layers
include conf/machine/${MACHINE}-extra.conf
```

## conf/distro/fsl-networking.conf
```bitbake
require conf/distro/poky.conf

DISTRO = "fsl-networking"
SDK_VENDOR = "-fsl"
SDK_VERSION = "Layerscape2-SDK"
MAINTAINER = "Freescale Yocto Team <yocto@linux.freescale.net>"

TARGET_VENDOR = "-fsl"

SDK_NAME = "${DISTRO}-${TCLIBC}-${SDK_ARCH}-${TUNE_PKGARCH}"

SANITY_TESTED_DISTROS += " \
            CentOS-7.0.1406 \n \
			Debian-7.0 \n \
            Debian-7.6 \n \
            Fedora-20 \n \
            LinuxMint-15 \n \
            SUSE-LINUX-13.2 \n \
			Ubuntu-12.04 \n \
            Ubuntu-14.04 \n \
        "
include conf/distro/include/ls2-networking-base.inc
include conf/distro/include/fsl-networking-sha-references.inc
include conf/include/fsl-toolchain-default-version.inc

INHERIT += "own-mirrors"
SOURCE_MIRROR_URL ?= "http://autobuilder.yoctoproject.org/sources/"

DISTRO_FEATURES_DEFAULT_append = " benchmark ext2 mtd alsa perl ppp python usbhost virtualization db"

ERROR_QA = "dev-so debug-deps dev-deps debug-files arch la2 pkgconfig la perms rpaths staticdev ldflags"
```

## conf/distro/include/ls2-networking-base.inc
```bitbake
# Provides the base settings for LS2

CW_PATH ?= "/opt/Freescale/CW4NET_v2015.05/CW_APP"

GCCVERSION = "linaro-4.8"
BINUVERSION = "linaro-2.24"
PREFERRED_VERSION_eglibc = "linaro-2.19"
PREFERRED_VERSION_nativesdk-eglibc = "linaro-2.19"
PREFERRED_VERSION_quagga = "0.99.9"
PREFERRED_VERSION_qemu = "2.3+fsl"
PREFERRED_VERSION_libvirt = "1.2.13"
PREFERRED_VERSION_python = "2.7.9"
PREFERRED_VERSION_python-native = "2.7.9"

# whitelisted restricted license
LICENSE_FLAGS_WHITELIST = "non-commercial_netperf"
```

## conf/layer.conf
```bitbake
# We have a conf and classes directory, add to BBPATH
# Note how we PREpend BBPATH. This is due to the fact that
# bitbake does not override classes per layer as it does
# recipes. Classes are processed strictly in BBPATH order.
# As we unfortunately have to override standard classes for
# bug fixing, we prepend instead of append our path.
BBPATH =. "${LAYERDIR}:"

FSL_EULA_FILE = "${LAYERDIR}/EULA"

LICENSE_PATH += "${LAYERDIR}/custom-licenses"

BBFILE_COLLECTIONS += "alb"
BBFILE_PATTERN_alb := "^${LAYERDIR}"
BBFILE_PRIORITY_alb = "8"

# The dynamic-layers directory hosts the extensions and layer specific
# modifications related to NXP products.
#
# The .bbappend and .bb files are included if the respective layer
# collection is available.
BBFILES += "${@' '.join('${LAYERDIR}/dynamic-layers/%s/recipes*/*/*.bbappend' % layer \
		for layer in BBFILE_COLLECTIONS.split())}"
BBFILES += "${@' '.join('${LAYERDIR}/dynamic-layers/%s/recipes*/*/*.bb' % layer \
		for layer in BBFILE_COLLECTIONS.split())}"

# We want our meta-alb recipes to be applied *after* the
# dynamic layer changes. This is for us to use the dynamic-layers to
# override existing layers before we apply our changes
BBFILES += " \
        ${LAYERDIR}/recipes-*/*/*.bb \
        ${LAYERDIR}/recipes-*/*/*.bbappend \
        ${LAYERDIR}/classes/*.bb* \
"

# Set LAYERSERIES_COMPAT variable for meta-alb layer
# to match the version "zeus" of OpenEmbedded-Core
LAYERSERIES_COMPAT_alb = "zeus dunfell gatesgarth"
```

## conf/machine/include/atf.inc
```bitbake
# Copyright 2020-2021 NXP
ATF_IMAGE = "arm-trusted-firmware"
ATF_IMAGE_FILE = "fip.s32-sdcard"
ATF_FLASH_IMAGE_FILE = "fip.s32-qspi"
UBOOT_NAME_SDCARD = "${ATF_IMAGE_FILE}"
FLASHIMAGE_UBOOT = "arm-trusted-firmware"
FLASHIMAGE_UBOOT_FILE = "${ATF_FLASH_IMAGE_FILE}"
```

## conf/machine/include/fsl-github-migrate.inc
```bitbake
# This is somewhat temporary for the move from codeaurora to github.
URL_MIGRATELIST = "//source.codeaurora.org/external/qoriq/qoriq-components/://github.com/nxp-qoriq/ //source.codeaurora.org/external/imx/://github.com/nxp-imx/"
INHERIT += "fsl-github-migrate"
BB_DANGLINGAPPENDS_WARNONLY = "1"
```

## conf/machine/include/hse-secboot.inc
```bitbake
# Copyright 2023 NXP

SDCARDIMAGE_BOOT_EXTRA_FILES:append = " arm-trusted-firmware:fip_rsa2048_public.pem"

DISTRO_FEATURES:append = " hse"
```

## conf/machine/include/ls208xa-base.inc
```bitbake
# Provides the common settings for LS208xA

require conf/machine/include/soc-family.inc

SOC_FAMILY = "fsl-lsch3:ls2:ls208xa"

IMAGE_FSTYPES = "tar.gz ext4"

# required for sdcard deploy
HOSTTOOLS += "parted mkfs.vfat mcopy udevadm"

EXTRA_IMAGECMD_ext4 = "-i 4096 -L ${IMAGE_NAME}"

EXTRA_IMAGEDEPENDS += "mc-utils management-complex ppa"

PREMIRRORS_prepend = " git://github.com/qoriq-open-source/ git://source.codeaurora.org/external/qoriq/qoriq-components/ \n "

# No better place for this if it should stay in the layer
PREFERRED_PROVIDER_jpeg ?= "libjpeg-turbo"
PREFERRED_PROVIDER_jpeg-native ?= "jpeg-native"


# Add and force using version 10.24.0, latest available with LS2084 support
# 10.24.1 from meta-qoriq does not have LS2084 support
PREFERRED_VERSION_management-complex = "10.24.0"

# Add and force using version 10.24.0, latest available with LS2084 support
# 10.24.1 from meta-qoriq does not have LS2084 support
PREFERRED_VERSION_management-complex = "10.24.0"

PREFERRED_VERSION_rng-tools ?= "5"
PREFERRED_VERSION_tcpreplay = "4.3.3"
PREFERRED_VERSION_dpdk = "19.11-20.04"

# For all other elements we use the SDK defaults
require conf/machine/include/qoriq-arm64.inc
require conf/machine/include/arm/arch-arm64.inc

DTB_LOAD = "0x90000000"
UBOOT_ENTRYPOINT = "0x80080000"

# We also want to permit SD card image generation.
# This sets up the defaults, just in case the image
# specifies an addition of "sdcard" to IMAGE_FSTYPES.
# Note that we can not boot U-Boot from SD Card on BB Classic
IMAGE_CLASSES += "image_types_fsl_sdcard"
SDCARD_ROOTFS ?= "ext4"
UBOOT_SUFFIX_SDCARD ?= "${UBOOT_SUFFIX}"

# 64 MB boot partition
BOOT_SPACE ?= "65536"

# Other types of images
IMAGE_CLASSES += "image_types_fsl_itb image_types_fsl_flashimage"

# Deploy rootfs type for bluebox images
IMAGE_ROOTFS_DEP_EXT ?= "ext4"
```

## conf/machine/include/lsflashmap.inc
```bitbake
# NOR/QSPI/NAND/SD (RCW on different offset on SD card!)

# Starting with the NXP DN LSDK, a common flash map exists for
# all QorIQ/Layerscape devices.
FLASHIMAGE_RESET_OFFSET		= "0x00000000"
FLASHIMAGE_RESET_SD_OFFSET	= "0x00001000"
FLASHIMAGE_UBOOT_OFFSET		= "0x00100000"
FLASHIMAGE_UBOOT_ENV_OFFSET	= "0x00300000"
FLASHIMAGE_PPA_OFFSET 		= "0x00400000"
FLASHIMAGE_SECBOOTHDR_OFFSET	= "0x00600000"
FLASHIMAGE_DPAA1_FMAN_OFFSET	= "0x00900000"
FLASHIMAGE_QE_OFFSET		= "0x00940000"
FLASHIMAGE_ETHPHY_OFFSET	= "0x00980000"
FLASHIMAGE_UBOOT_SCR_OFFSET	= "0x009c0000"
FLASHIMAGE_DPAA2_MC_OFFSET	= "0x00a00000"
FLASHIMAGE_DPAA2_DPL_OFFSET	= "0x00d00000"
FLASHIMAGE_DPAA2_DPC_OFFSET	= "0x00e00000"
FLASHIMAGE_UEFI_DTB_OFFSET	= "0x00f00000"
FLASHIMAGE_KERNEL_OFFSET	= "0x01000000"
FLASHIMAGE_ROOTFS_OFFSET	= "0x02000000"
```

## conf/machine/include/lxflashmap.inc
```bitbake
# NOR/QSPI/NAND/SD (RCW on different offset on SD card!)

# Flash map for recent LSDK based devices. It is slightly
# different from the earlier flashmaps
FLASHIMAGE_RESET_OFFSET		= "0x00000000"
FLASHIMAGE_RESET_SD_OFFSET	= "0x00001000"
FLASHIMAGE_UBOOT_OFFSET		= "0x00100000"
FLASHIMAGE_UBOOT_ENV_OFFSET	= "0x00500000"
FLASHIMAGE_SECBOOTHDR_OFFSET	= "0x00600000"
FLASHIMAGE_DDR_PHY_OFFSET 	= "0x00800000"
FLASHIMAGE_DPAA1_FMAN_OFFSET	= "0x00900000"
FLASHIMAGE_QE_OFFSET		= "0x00940000"
FLASHIMAGE_ETHPHY_OFFSET	= "0x00980000"
FLASHIMAGE_UBOOT_SCR_OFFSET	= "0x009c0000"
FLASHIMAGE_DPAA2_MC_OFFSET	= "0x00a00000"
FLASHIMAGE_DPAA2_DPL_OFFSET	= "0x00d00000"
FLASHIMAGE_DPAA2_DPC_OFFSET	= "0x00e00000"
FLASHIMAGE_UEFI_DTB_OFFSET	= "0x00f00000"
FLASHIMAGE_KERNEL_OFFSET	= "0x01000000"
FLASHIMAGE_ROOTFS_OFFSET	= "0x02000000"
```

## conf/machine/include/m7-boot.inc
```bitbake
# Copyright 2021 NXP

IMAGE_BOOTLOADER_RECIPE = "m7-sample"
FLASHIMAGE_UBOOT = "m7-sample"

UBOOT_NAME_SDCARD = "fip.s32-sdcard.m7"
FLASHIMAGE_UBOOT_FILE = "fip.s32-qspi.m7"

ATF_IMAGE = "fip.s32-qspi.m7"
```

## conf/machine/include/nodistropackage.inc
```bitbake
# To build foreign distro images , we do not want to deploy all Yocto
# packages, but we need their sysroot data for building other packages

# The trick really is that things like PREFERRED_PROVIDER only apply
# to the package generation. The final build step for a rootfs will
# use any package it can find unless PACKAGE_EXCLUDE is used, and
# that only works for RPM.
# Given that the ubuntu-base files already provide essential packages
# that we must not overwrite, the solution is to redirect provider use.
# We still need to build the recipes though because packages that we
# *do* want to deploy may need their header files etc.

def dnwp_checkpackagematch(d, pn, patternvar):
    import re
    for pattern in (d.getVar(patternvar) or '').split():
        pnpattern, pkglist, preferredprovider = (pattern.split(':') + 3 * [None])[:3]
        if not pnpattern:
            bb.error("Missing recipe name in nodistropackage")
        if (pn and re.match('^' + pnpattern + '$', pn)):
            if not pkglist:
                pkglist = pnpattern
            pkglist = pkglist.split(',')
            return pnpattern, pkglist, preferredprovider
    return None, None, None

def dnwp_nopackagewrites(d):
    pn = (d.getVar('PN') or '')
    foundnowritepkg, fnwpkglist, fnwprp = dnwp_checkpackagematch(d, pn, 'DISTRO_NEVER_WRITE_PACKAGE')
    foundwritepkg,   fwpkglist,  fwprp  = dnwp_checkpackagematch(d, pn, 'DISTRO_ALWAYS_WRITE_PACKAGE')
    if foundnowritepkg and not foundwritepkg:
        d.appendVar('PACKAGE_EXCLUDE_' + pn, ' ${PACKAGES}')

def dnwp_prefrprov(d):
    # This is really a workaround only, which is limiting the
    # intended flexibility of the mechanism overall. However,
    # I could not find another way to properly set the preferred
    # rprovider. See also dnwp_nopackagewrites() for where this
    # really should happen.
    # I wish I knew how to access all package names at that time
    # but the recipes are not parsed yet ...
    rp = d.getVar('DISTRO_DEFAULT_RPROVIDER')
    dawp = (d.getVar('DISTRO_ALWAYS_WRITE_PACKAGE') or '').split()
    for pattern in (d.getVar('DISTRO_NEVER_WRITE_PACKAGE') or '').split():
        pnpattern, packagelist, preferredrprovider = (pattern.split(':') + 3 * [None])[:3]
        if not pnpattern:
            bb.error("Missing recipe name in nodistropackage")
        preferredrprovider = preferredrprovider or rp
        if preferredrprovider:
            foundalwayswrite = False
            for dawpatten in dawp:
                dawpnpattern, dawpackagelist, dawpreferredrprovider = (dawpattern.split(':') + 3 * [None])[:3]
                # Note that we use pnpattern, i.e., this
                # workaround does not permit us to use real
                # pn names because we can not match against
                # the real recipe names. Hmpf.
                if (pn and re.match("^" + dawpnpattern  + "$", pnpattern)):
                    foundalwayswrite = True
                    break

            if not foundalwayswrite:
                if not packagelist:
                    packagelist = pnpattern
                packagelist = packagelist.split(',')
                for p in packagelist:
                    d.setVar('PREFERRED_RPROVIDER_' + p, preferredrprovider)

addhandler distro_never_write_package_pre
distro_never_write_package_pre[eventmask] = "bb.event.ConfigParsed"
python distro_never_write_package_pre () {
    dnwp_prefrprov(d)
}

# This is run after the keys have been expanded, i.e., we can find
# RDEPENDS_<pn> then directly for any name. The idea is that we check
# if any dependency is one that we convert to a different
# PREFERRED_RPROVIDER and fix up the RDEPENDS to avoid file-rdeps
# complaints on packaging.
def dnwp_fixuprdepends(d):
    dp = d.getVar('DISTRO_DEFAULT_RPROVIDER')

    modified = False
    for ppn in (d.getVar('PACKAGES') or '').split():
        rdepkey = 'RDEPENDS_' + ppn
        rpmodified = False
        rdepends = bb.utils.explode_dep_versions2(d.getVar(rdepkey) or '')
        newrdepends = {}
        for rdep in rdepends:
            foundnordeppkg,  fnrpkglist, fnrprp = dnwp_checkpackagematch(d, rdep, 'DISTRO_NEVER_WRITE_PACKAGE')
            foundrdeppkg,    frpkglist,  frprp  = dnwp_checkpackagematch(d, rdep, 'DISTRO_ALWAYS_WRITE_PACKAGE')
            origrdep = rdep
            if foundnordeppkg and not foundrdeppkg:
                fnrprp = fnrprp or dp
                if fnrprp and fnrprp not in newrdepends:
                    rdep = fnrprp
                    rpmodified = True
                    modified = True
            newrdepends[rdep] = rdepends[origrdep]
        if rpmodified:
            d.setVar(rdepkey, bb.utils.join_deps(newrdepends, commasep=False))

            # If we have changed the rdepends, the result is that the build
            # dependency no longer matches the redepends. This means that we
            # need to skip build-dep warnings. This is a bit ugly, but
            # it is a reasonable solution to the QA problem.
            d.appendVar('INSANE_SKIP_' +  ppn, ' build-deps')

python () {
    dnwp_fixuprdepends(d)
    dnwp_nopackagewrites(d)
}
```

## conf/machine/include/openssl_version.inc
```bitbake
# poky (sumo) hardcode the preferred vesion for openssl to 1.0.%,
# in meta/conf/distro/include/default-versions.inc
#     PREFERRED_VERSION_openssl = "1.0.%"
# The assignment can not be overrided in meta-alb files, as it is "=" instead
# of "?="
# To fix the poky hardcoding, this file set the variable to the desired version


OPENSSLVERSION ?= "1.1.1c"

def openssl_version(d):
	newversion = d.getVar('OPENSSLVERSION')
	d.setVar('PREFERRED_VERSION_openssl', newversion)
	d.setVar('PREFERRED_VERSION_openssl-native', newversion)
	d.setVar('PREFERRED_VERSION_nativesdk-openssl', newversion)



addhandler openssl_version_handler
openssl_version_handler[eventmask] = "bb.event.ConfigParsed"
python openssl_version_handler () {
	openssl_version(d)
}
```

## conf/machine/include/qoriq-atf.inc
```bitbake
# Copyright 2023 NXP

ATF = "qoriq-atf"
ATF_RESET_FILE_NOR = "atf/bl2_nor.pbl"
ATF_IMAGE_FILE_NOR = "atf/fip_uboot.bin"
ATF_RESET_FILE_SD = "atf/bl2_sd.pbl"
ATF_IMAGE_FILE_SD = "atf/fip_uboot.bin"
ATF_RESET_FILE_XSPI = "atf/bl2_flexspi_nor.pbl"
ATF_IMAGE_FILE_XSPI = "atf/fip_uboot.bin"
ATF_RESET_FILE_QSPI = "atf/bl2_qspi.pbl"
ATF_IMAGE_FILE_QSPI = "atf/fip_uboot.bin"
```
