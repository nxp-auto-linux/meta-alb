## conf/machine/include/qoriq-common.inc
```bitbake
# This file serves for common QorIQ machine settings/workarounds

# meta-qoriq has a single dangling bbappend for an image that we are not
# providing. Hence, we mask this bbappend file.
BBMASK += "meta-qoriq/recipes-fsl/images/fsl-image-multimedia-full.bbappend"

# We don't want the QorIQ Ethernet naming rewrites
# This affects all images not only based on core-image-minimal
MACHINE_EXTRA_RRECOMMENDS:remove = "udev-rules-qoriq"
```

## conf/machine/include/qoriq-ppc.inc
```bitbake
# Provides the common settings for QorIQ PPC

KERNEL_IMAGETYPE ?= "uImage"

SERIAL_CONSOLES ?= "115200;ttyS0 115200;ttyS1 115200;ttyEHV0"
SERIAL_CONSOLES_CHECK ?= "${SERIAL_CONSOLES}"

MACHINEOVERRIDES =. "qoriq-ppc:"

require conf/machine/include/qoriq-base.inc

GCCVERSION_qoriq-ppc = "6.3.0"
BINUVERSION_qoriq-ppc = "2.29.1"
GLIBCVERSION_qoriq-ppc = "2.20"
PREFERRED_VERSION_virtual/nativesdk-libiconv = "2.20"
```

## conf/machine/include/s32-base.inc
```bitbake
require conf/machine/include/soc-family.inc
require conf/machine/include/arm/arch-arm64.inc

SOC_FAMILY = "s32"

# Provides the common settings for S32 targets
# Machines may include this file directly, if little to no changes are
# required for their definitions.
# Otherwise, intermediate include files should be
# created for various families (e.g. s32v-base.inc, s32g-base.inc etc)

KERNEL_IMAGETYPE ?= "Image"

BOOT_SPACE ?= "65536"

# required for u-boot
HOSTTOOLS += "comm"

# required for sdcard deploy
HOSTTOOLS += "parted mkfs.vfat mcopy"

# S32 BSP default providers
PREFERRED_PROVIDER_u-boot ?= "u-boot-s32"
PREFERRED_PROVIDER_virtual/bootloader ?= "u-boot-s32"
PREFERRED_PROVIDER_virtual/kernel = "linux-s32"

PREFERRED_VERSION_linux-s32 ?= "5.10.41"
PREFERRED_VERSION_u-boot-s32 ?= "2020.04"
PREFERRED_VERSION_xen ?= "4.14"

PREFERRED_VERSION_rng-tools ?= "5"
PREFERRED_VERSION_tcpreplay ?= "4.3.3"

# ensure bison is not removed from sysroot, otherwise
# some build tasks e.g. kernel 'do_merge_delta_config' will fail
SSTATE_EXCLUDEDEPS_SYSROOT_remove = ".*->bison-native"

UBOOT_BOOTSPACE_SEEK ?= "8"
UBOOT_KERNEL_IMAGETYPE ?= "Image"
UBOOT_ENTRYPOINT ?= "80080000"
# Comment next line to prevent writing the environment to sdcard
UBOOT_ENV_SDCARD_OFFSET ??= "0x00100000"

#s32 has no hardware clock
MACHINE_FEATURES_BACKFILL_CONSIDERED = "rtc"

# we do not want to have getty running on tty1 as we run
# auto-serial-console there USE_VT = "0"
SERIAL_CONSOLES ?= "115200;ttyLF0"

SOC_DEFAULT_IMAGE_FSTYPES = "tar.gz"
IMAGE_FSTYPES ?= "${SOC_DEFAULT_IMAGE_FSTYPES}"

MACHINE_FEATURES ?= "pci ext2 ext4 serial"
MACHINE_EXTRA_RRECOMMENDS += "udev-extraconf kernel-modules"

EXTRA_IMAGEDEPENDS += "u-boot-s32 "

# Sub-architecture support
MACHINE_SOCARCH_SUFFIX ?= ""
MACHINE_SOCARCH_SUFFIX_s32 = "-s32"

MACHINE_ARCH_FILTER = "virtual/kernel"

INHERIT += "fsl-dynamic-packagearch"

# Mask some recipes which address other architectures, and
# which reside in layers that we may not use for S32
BBMASK = "u-boot-qoriq linux-qoriq"

# Xen Examples support variables
DOM0LESS_ROOTFS ?= "fsl-image-dom0less"
XEN_EXAMPLE ?= "xen-examples-default"
```

## conf/machine/include/s32-gen1-board.inc
```bitbake
require conf/machine/include/s32-gen1.inc

EXTRA_IMAGECMD_ext4 = "-i 4096 -L ${IMAGE_NAME}"
IMAGE_FSTYPES_remove = "jffs2 ubi ext2.gz ext2.gz.u-boot"

UBOOT_BOOTSPACE_OFFSET = "0"
UBOOT_BOOTSPACE_SEEK = "0"

# Define dependencies for .flashimage
# Offset values are in bytes and are deduced from the values defined in
# u-boot/include/configs/s32.h as {KERNEL|FDT|RAMDISK}_FLASH_ADDR
FLASHIMAGE_UBOOT_TYPE = "qspi"
# Normally only FLASHIMAGE_UBOOT_TYPE should be enough, but we also define
# the *_SUFFIX and *_FILE for safety
require conf/machine/include/s32gen1flashmap.inc
FLASHIMAGE_SIZE="64"
FLASHIMAGE_UBOOT_SUFFIX = "${UBOOT_SUFFIX}"
FLASHIMAGE_KERNEL_FILE = "${KERNEL_IMAGETYPE}"
FLASHIMAGE_DTB_SUFFIX = "dtb"
FLASHIMAGE_EXTRA1 = "linux-s32"
FLASHIMAGE_EXTRA1_OFFSET = "${FLASHIMAGE_DTB_OFFSET}"
FLASHIMAGE_ROOTFS = "fsl-image-base"
FLASHIMAGE_ROOTFS_SUFFIX = "cpio.gz.u-boot"
FLASHIMAGE_ROOTFS_FILE = "${DEPLOY_DIR_IMAGE}/${FLASHIMAGE_ROOTFS}-${MACHINE}.${FLASHIMAGE_ROOTFS_SUFFIX}"

IMAGE_FSTYPES += "${FLASHIMAGE_ROOTFS_SUFFIX}"

# Add extra sdcard partition with rootfs image if Xen enabled
SDCARD_ROOTFS_EXTRA1_FILE ?= "${@bb.utils.contains('DISTRO_FEATURES', 'xen', '${IMGDEPLOYDIR}/${IMAGE_NAME}${IMAGE_NAME_SUFFIX}.${SDCARD_ROOTFS_EXT}', '', d)}"
SDCARD_ROOTFS_EXTRA1_SIZE ?= "${@bb.utils.contains('DISTRO_FEATURES', 'xen', '${ROOTFS_SIZE}', '0', d)}"
```

## conf/machine/include/s32-gen1.inc
```bitbake
require conf/machine/include/s32-base.inc

SOC_FAMILY_append = ":gen1"

IMAGE_FSTYPES += "ext4"

# Specific definitions for .sdcard image generation
IMAGE_FSTYPES += "sdcard"
SDCARD_ROOTFS = "ext4"

UBOOT_SUFFIX_SDCARD = "${UBOOT_SUFFIX}"
IMAGE_CLASSES += "image_types_fsl_sdcard"

# Permit later to optionally add flashimage to IMAGE_FSTYPES
IMAGE_CLASSES += "image_types_fsl_flashimage"

UBOOT_ENV_SDCARD_OFFSET ?= "0x001e0000"

# Enable DM-Verity
require ${@bb.utils.contains('DISTRO_FEATURES', 'dm-verity', 'conf/machine/include/s32-gen1-dm-verity.inc', '', d)}

# When m7boot is enabled, the needed ATF settings are included from m7-boot.inc
require ${@bb.utils.contains('DISTRO_FEATURES', 'm7boot', 'conf/machine/include/m7-boot.inc', 'conf/machine/include/atf.inc', d)}
```

## conf/machine/include/s32-gmac.inc
```bitbake
PREFERRED_VERSION_gmac = "${@bb.utils.contains('PREFERRED_VERSION_linux-s32', '4.14', '0.4.1', '0.4.2', d)}"
# For kernel 4.14 we have a separate gmac recipe; for kernel 4.19, gmac is built with the kernel
GMAC_IMAGE_INSTALL = "${@bb.utils.contains('PREFERRED_VERSION_linux-s32', '4.14', 'gmac', '', d)}"

# Add gmac by default
DISTRO_FEATURES_append += "${@bb.utils.contains('PREFERRED_VERSION_linux-s32', '4.14', ' gmac', '', d)}"
```

## conf/machine/include/s32-sim-base.inc
```bitbake
require conf/machine/include/s32-base.inc

IMAGE_FSTYPES += "cpio.gz"
IMAGE_FSTYPES:remove = "flashimage"

KERNEL_DEFCONFIG ?= "s32cc_defconfig"

UBOOT_CONFIG = "cpio"

VIRTUAL-RUNTIME_dev_manager = "busybox-mdev"
VIRTUAL-RUNTIME_login_manager = "busybox"
VIRTUAL-RUNTIME_init_manager = "busybox"
VIRTUAL-RUNTIME_initscripts = "initscripts"
VIRTUAL-RUNTIME_keymaps = "keymaps"
DISTRO_FEATURES:append = " virtio"
DISTRO_FEATURES:remove = "systemd"

SOC_FAMILY:append = ":s32cc"
```

## conf/machine/include/s32-ubuntu-board.inc
```bitbake
require conf/machine/include/ubuntubasics.inc

FLASHIMAGE_ROOTFS = "fsl-image-ubuntu-base"

BOOT_SCRIPTS = ""
DISTRO_FEATURES:append = " docker"
```

## conf/machine/include/s32cc-board.inc
```bitbake
require conf/machine/include/s32cc.inc

EXTRA_IMAGECMD:ext4 = "-i 4096 -L ${IMAGE_NAME}"
IMAGE_FSTYPES:remove = "jffs2 ubi ext2.gz ext2.gz.u-boot"

UBOOT_BOOTSPACE_OFFSET = "0"
UBOOT_BOOTSPACE_SEEK = "0"

# Define dependencies for .flashimage
# Offset values are in bytes and are deduced from the values defined in
# u-boot/include/configs/s32.h as {KERNEL|FDT|RAMDISK}_FLASH_ADDR
FLASHIMAGE_UBOOT_TYPE = "qspi"
# Normally only FLASHIMAGE_UBOOT_TYPE should be enough, but we also define
# the *_SUFFIX and *_FILE for safety
FLASHIMAGE_SIZE="64"
FLASHIMAGE_UBOOT_SUFFIX = "${UBOOT_SUFFIX}"
FLASHIMAGE_KERNEL_FILE = "${KERNEL_IMAGETYPE}"
FLASHIMAGE_DTB_SUFFIX = "dtb"
FLASHIMAGE_DTB = "linux-s32"
FLASHIMAGE_ROOTFS = "fsl-image-base"
FLASHIMAGE_ROOTFS_SUFFIX = "cpio.gz.u-boot"
FLASHIMAGE_ROOTFS_FILE = "${DEPLOY_DIR_IMAGE}/${FLASHIMAGE_ROOTFS}-${MACHINE}.${FLASHIMAGE_ROOTFS_SUFFIX}"

IMAGE_FSTYPES += "${FLASHIMAGE_ROOTFS_SUFFIX}"

# Add extra sdcard partition with rootfs image if Xen enabled
SDCARD_ROOTFS_EXTRA1_FILE ?= "${@bb.utils.contains('DISTRO_FEATURES', 'xen', '${IMGDEPLOYDIR}/${IMAGE_NAME}${IMAGE_NAME_SUFFIX}.${SDCARD_ROOTFS_EXT}', '', d)}"
SDCARD_ROOTFS_EXTRA1_SIZE ?= "${@bb.utils.contains('DISTRO_FEATURES', 'xen', '${ROOTFS_SIZE}', '0', d)}"
```

## conf/machine/include/s32cc-dm-verity.inc
```bitbake
DM_VERITY_IMAGE ?= "fsl-image-base"
DM_VERITY_IMAGE_TYPE = "ext3"
IMAGE_CLASSES += "dm-verity-img"

INITRAMFS_IMAGE = "dm-verity-image-initramfs"
INITRAMFS_FSTYPES = "cpio.gz cpio.gz.u-boot"
INITRAMFS_IMAGE_BUNDLE = "1"

IMAGE_BOOT_FILES:remove = "Image"
IMAGE_BOOT_FILES:append = " Image-initramfs-${MACHINE}.bin;Image"
IMAGE_BOOT_FILES:append = " ${@os.path.basename(d.getVar("KERNEL_DEVICETREE"))}"

WKS_FILE = "s32cc-sdimage-verity.wks.in"
```
