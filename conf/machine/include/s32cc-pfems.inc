## conf/machine/include/ubuntubasics.inc
```bitbake
# We currently support recipies for:
# - 20.04.1
# - 22.04.1
#UBUNTU_TARGET_VERSION ?= "20.04.1"
UBUNTU_TARGET_VERSION ?= "22.04.1"

UBUNTU_TARGET_MAJORVERSION ?= "${@d.getVar('UBUNTU_TARGET_VERSION', True).rsplit('.')[0]}"
UBUNTU_TARGET_MINORVERSION ?= "${@d.getVar('UBUNTU_TARGET_VERSION', True).rsplit('.')[1]}"
UBUNTU_TARGET_SUBVERSION ?= "${@d.getVar('UBUNTU_TARGET_VERSION', True).rsplit('.')[2]}"
UBUNTU_TARGET_BASEVERSION ?= "${UBUNTU_TARGET_MAJORVERSION}.${UBUNTU_TARGET_MINORVERSION}"
REQUIRED_VERSION_ubuntu-base = "${UBUNTU_TARGET_VERSION}"

# I am sure there are smarter ways to map the architecture. This works
# initially. FIX
UBUNTU_TARGET_ARCH="${@d.getVar('TRANSLATED_TARGET_ARCH', True).replace("aarch64", "arm64")}"

# Downconfigure Yocto environment to not pull in local things
# We do not want any default post intercepts or special default
# packages added.
IMAGE_LINGUAS = ""
POKY_DEFAULT_EXTRA_RDEPENDS:remove = "packagegroup-core-boot"
INITRAMFS_IMAGE = ""
POSTINST_INTERCEPTS_DIR = "<--InVaLiD-->"

# We really should also have this line active, but recipe deficiencies
# make this a non-option currently
#FILESYSTEM_PERMS_TABLES = ""

# Ubuntu does not use /var/volatile
VOLATILE_LOG_DIR = "no"

# Removal of flash image filesystem support
# for Ubuntu images due to an issue regarding 'cpio'
# utility when seeking on large files (> 2 GB).
# As a Ubuntu based rootfs can easily go beyond 2GB and are even in
# the smallest form larger than what is good for a boot flash, we
# do not generate a .flashimage with Ubuntu.
IMAGE_FSTYPES:remove = "flashimage"
IMAGE_TYPES_MASKED += "cpio cpio.gz cpio.gz.u-boot"

# The Yocto glibc version must not exceed the Ubuntu glibc version
# or Yocto-created executables will fail on the Ubuntu image.
# We want to be as close as possible to the respective Ubuntu glibc
# version to avoid compatibility issues.
# The glibc version for a given Ubuntu release is a-priori knowledge,
# so the suitable Yocto version can be selected here.
# Note that the glibc is not compiled in Ubuntu identical fashion.
# It remains a glibc that works for Yocto, which is good enough for
# our purposes.
# Ubuntu 20.x: max glibc 2.31...
# Ubuntu 22.x: max glibc 2.35...
GLIBCVERSION = '${@ \
    oe.utils.conditional("UBUNTU_TARGET_BASEVERSION", "20.04", "2.31%", \
    oe.utils.conditional("UBUNTU_TARGET_BASEVERSION", "22.04", "2.35", \
    "unsupportedubuntuversion" \
    , d) \
    , d)}'
BINUVERSION='${@ \
    oe.utils.conditional("UBUNTU_TARGET_BASEVERSION", "20.04", "2.34", \
    oe.utils.conditional("UBUNTU_TARGET_BASEVERSION", "22.04", "2.38", \
    "unsupportedubuntuversion" \
    , d) \
    , d)}'

# We need to understand the python version in Ubuntu for dependency
# management
APTGET_PYTHON_VER = '${@ \
    oe.utils.conditional("UBUNTU_TARGET_BASEVERSION", "20.04", "3.8", \
    oe.utils.conditional("UBUNTU_TARGET_BASEVERSION", "22.04", "3.10", \
    "unsupportedubuntuversion" \
    , d) \
    , d)}'


# More recent Ubuntu versions work with symlinks for the base
# directories. We can't refer to symlink based files
DISTRO_FEATURES:append = '${@ \
    oe.utils.conditional("UBUNTU_TARGET_BASEVERSION", "20.04", " usrmerge", \
    oe.utils.conditional("UBUNTU_TARGET_BASEVERSION", "22.04", " usrmerge", \
   "unsupportedubuntuversion" \
    , d) \
    , d)}'

# This is to be able to pull in the prebuilt Ubuntu rootfs
MACHINEOVERRIDES =. "ubuntu:"

# When creating images, we would like to preserve any extended
# attributes that are part of our rootfs
IMAGE_CMD_TAR = "tar --xattrs --xattrs-include=*"
do_image_tar[depends] += "tar-replacement-native:do_populate_sysroot"
EXTRANATIVEPATH += "tar-native"

# We influence the setup to match Ubuntu more properly as otherwise
# Yocto behavior may conflict with the Ubuntu rootfs.
INIT_MANAGER = "systemd"

# Turns out that we want the Yocto recipes as default provider, but
# then we must ensure they do not get deployed to avoid pollution of
# the target rootfs.
# Rationale is that Yocto builds need to be internally consistent,
# and we need the sysroots info for Yocto recipes, but the Ubuntu rootfs
# provides things, too. We can't use that for building though, so Yocto
# packages conflicting must not reach the package manager.
# Whenever a Yocto package is installed, all dependencies which are
# to be provided by Ubuntu must be added to the list. Check
# recipe-depends.dot from bitbake -g.
# The respective Ubuntu image must then install the Ubuntu version of
# the recipe.
require conf/machine/include/nodistropackage.inc

# DISTRO_NEVER_WRITE_PACKAGE format:
# <package name>[:[packagelist]:[preferred rprovider]:[virt-runtime]]
# Where:
#     package name: recipe name. Mandatory parameter
# Optional parameters:
#     packagelist:  list of comma-separated package names
#     rprovider:    specify the preferred rprovider if different than default
#                   (e.g. ubuntu-base)
#     virt-runtime: 0/1:disable(0) or enable(1) overwritting VIRTUAL-RUNTIME
#                   with preferred rprovider. Default is (if not specified)
#                   disable. This is required for pkgs that are directly
#                   referrenced with VIRTUAL-RUNTIME (e.g. update-alternatives)

DISTRO_NEVER_WRITE_PACKAGE:class-target += "\
    alsa-conf \
    alsa-lib \
    update-alternatives:::1 \
    bash \
    base-files \
    base-passwd \
    bc \
    bison \
    bluez5 \
    busybox \
    bzip2 \
    ca-certificates \
    coreutils \
    db \
    dbus \
    diffutils \
    dpkg \
    dtc \
    e2fsprogs \
    ethtool \
    file \
    findutils \
    flex \
    gawk \
    gcc:gcc,gcc-plugins \
    gcc-runtime \
    gdbm \
    initscripts \
    iproute2 \
    iproute2-devlink \
    iputils-ping \
    kmod \
    libc6 \
    libc6-utils \
    libffi \
    libgcc \
    liblzma \
    libmpc:libmpc,libmpc-dev \
    libnsl2 \
    libpam \
    libpam-runtime \
    libsqlite3 \
    libxml2 \
    m4 \
    ncurses \
    ncurses-terminfo-base \
    netbase \
    net-tools \
    opkg-utils \
    perl \
    procps \
    python3 \
    python3-core \
    qemuwrapper-cross \
    shared-mime-info \
    sqlite3 \
    tar \
    readline \
    util-linux \
    xz \
    zlib \
"

# glibc has many subpackages, some of them cause a direct conflict
# with Ubuntu
DISTRO_NEVER_WRITE_PACKAGE:class-target += "\
    glibc \
    glibc-locale \
    libsegfault \
"

# We have some packages which we do not want to have in a target
# image because they are available as Ubuntu-native packages.
# Given that we can't set a PREFERRED_RPROVIDER in an image recipe
# we need to isolate those packages globally.
DISTRO_NEVER_WRITE_PACKAGE:class-target += "\
    openssl \
    openssl-bin \
    openssl-conf \
    openssl-dev \
    openssl-qoriq \
    openssl-qoriq-bin \
    openssl-qoriq-conf \
    openssl-qoriq-dev \
"

# All the runtime above should come from ubuntu-base or a derived image
# but only for the target, not for native elements.
# The trick is that we need to retarget everything to one recipe because
# at configuration time we cannot predict algorithmically which derived
# images would add the final apt packages. Any "missing" dependencies
# would only show up then at image build time.
DISTRO_DEFAULT_RPROVIDER:class-target = "ubuntu-base (= ${UBUNTU_TARGET_VERSION})"

#require conf/machine/include/ubuntutcconf.inc
```

## conf/machine/include/ubuntutcconf.inc
```bitbake
# Assign the external toolchain if no other value is already assigned (default assignment)
# Any user's setting (using '=') will overide this default assignment
# On the other hand is safe to set the default value as the toolchain selection
# is decided first based on the TCMODE and TCLIBC. If no external toolchain is set
# (e.g. TCMODE="default"), this default assignment will be ignored
EXTERNAL_TOOLCHAIN ?= "${TOPDIR}/tmp/ext-toolchain/usr"

# Default assignment: as above, user setting will override this default asignment
# TCMODE is needed before an event handler or anonymous python function is called
TCMODE ?= "${@toolchain_get_tcmode(d)}"


# Default assignment: as above, user setting will override this default asignment
# TCLIB is needed before an event handler or anonymous python function is called
TCLIBC ?= "${@toolchain_get_tclibc(d)}"

# Overall, the toolchain selection is done based on the following algorithm:
#
#  * if the user set (in local.conf) the external toolchain: use this
#    toolchain accordingly to the user's settings
#
#  * else, if the Ubuntu cross toolchain is installed in standard
#    location (/usr/<arch>-linux-gnu), use this as external toolchain
#
#  * else, use the standard Yocto toolchain



ELT_TARGET_SYS ?= "${TARGET_ARCH}-linux-gnu"
BASE_EXT_TC ?= "/usr"

myshell_install_ext_toolchain() {

	# It is assumed that the Ubuntu toolchain is installed on the Host
	# The user should install the required packages, as below:
	#
	# sudo apt-get install gcc-aarch64-linux-gnu
	# sudo apt-get install g++-aarch64-linux-gnu
	# sudo apt-get install libc6-dev-arm64-cross
	# These commands will install the toolchain in /usr - se BASE_EXT_TC

	# In order to be shaped like a standard linaro toolchain we do some
	# preparation: create dummy file, create symlinks
	# This is done in  ${EXTERNAL_TOOLCHAIN} to avoid changing the system
	# /usr folder

	# TODO:
	# This is a temporary solution. The target is to install the required
	# packages in a fakeroot.


	if ! [ -d ${EXTERNAL_TOOLCHAIN} ]; then
		/usr/bin/install -d ${EXTERNAL_TOOLCHAIN}
	fi

	if ! [ -d ${EXTERNAL_TOOLCHAIN}/${ELT_TARGET_SYS} ]; then
		/usr/bin/install -d ${EXTERNAL_TOOLCHAIN}/${ELT_TARGET_SYS}
		/bin/ln -s ${BASE_EXT_TC}/${ELT_TARGET_SYS}/bin ${EXTERNAL_TOOLCHAIN}/${ELT_TARGET_SYS}/bin
		/bin/ln -s ${BASE_EXT_TC}/${ELT_TARGET_SYS}/include ${EXTERNAL_TOOLCHAIN}/${ELT_TARGET_SYS}/include
		/bin/ln -s ${BASE_EXT_TC}/${ELT_TARGET_SYS}/lib ${EXTERNAL_TOOLCHAIN}/${ELT_TARGET_SYS}/lib

	fi

	if ! [ -d ${EXTERNAL_TOOLCHAIN}/bin ]; then
		/usr/bin/install -d ${EXTERNAL_TOOLCHAIN}/bin
		/bin/ln -s ${BASE_EXT_TC}/bin/${ELT_TARGET_SYS}-* ${EXTERNAL_TOOLCHAIN}/bin/
	fi

	if ! [ -d ${EXTERNAL_TOOLCHAIN}/${ELT_TARGET_SYS}/libc/usr ]; then
		/usr/bin/install -d ${EXTERNAL_TOOLCHAIN}/${ELT_TARGET_SYS}/libc/usr
	fi

	if ! [ -d ${EXTERNAL_TOOLCHAIN}/${ELT_TARGET_SYS}/libc/usr/lib ]; then
		/bin/ln -s ${EXTERNAL_TOOLCHAIN}/${ELT_TARGET_SYS}/lib ${EXTERNAL_TOOLCHAIN}/${ELT_TARGET_SYS}/libc/usr/lib
	fi

	if ! [ -d ${EXTERNAL_TOOLCHAIN}/${ELT_TARGET_SYS}/libc/usr/include ]; then
		/bin/ln -s ${EXTERNAL_TOOLCHAIN}/${ELT_TARGET_SYS}/include ${EXTERNAL_TOOLCHAIN}/${ELT_TARGET_SYS}/libc/usr/include
	fi

	if ! [ -d ${EXTERNAL_TOOLCHAIN}/${ELT_TARGET_SYS}/libc/usr/share ]; then
		/usr/bin/install -d ${EXTERNAL_TOOLCHAIN}/${ELT_TARGET_SYS}/libc/usr/share
		/usr/bin/touch ${EXTERNAL_TOOLCHAIN}/${ELT_TARGET_SYS}/libc/usr/share/empty
	fi
}


def run_cmd(d, cmd, *args):
    import bb.process
    import subprocess

    args = [cmd] + list(args)
    topdir = d.getVar('TOPDIR', True)
    return bb.process.run(args, cwd=topdir, stderr=subprocess.PIPE)


def get_version(d, gcc):
    try:
        stdout, stderr = run_cmd(d, gcc, '-v')
    except bb.process.CmdError as exc:
        bb.warn('Failed to execute external toolchain command')
        return 'UNKNOWN'
    else:
        return stderr.splitlines()[-1]


def ubuntu_ext_toolchain(d):
    arch = d.getVar("TARGET_ARCH", True)
    base = d.getVar("BASE_EXT_TC", True)

    # We support the Ubuntu-Toolchain only if the host version
    # matches the target version!
    ubv = d.getVar('UBUNTU_TARGET_BASEVERSION')
    if not ubv:
        bb.error("Do not try to run a Ubuntu build without UBUNTU_TARGET_BASEVERSION set!")
        return False
    if not os.path.exists('/etc/lsb-release'):
        bb.debug(1, "Cannot identify host. Defaulting to Yocto toolchain.")
        return False

    ubuntu_rel = {
        'DISTRIB_ID' : None,
        'DISTRIB_RELEASE' : None,
        'DISTRIB_CODENAME' : None,
    }
    with open('/etc/lsb-release') as rel_file:
        for line in rel_file:
            if not '=' in line:
                continue
            key, value = line.split("=", 1)
            if key in ubuntu_rel:
                ubuntu_rel[key] = value.rstrip()

    if ubuntu_rel['DISTRIB_ID'] != "Ubuntu" or not ubuntu_rel['DISTRIB_RELEASE']:
        bb.debug(1, "Host is not running Ubuntu. Using Yocto toolchain.")
        return False
    if ubv != ubuntu_rel['DISTRIB_RELEASE']:
        bb.debug(1, "Ubuntu host version conflict %s vs %s for target" % (ubuntu_rel['DISTRIB_RELEASE'], ubv))
        return False

    elt_target =  "%s-linux-gnu" % arch
    host_tc ="%s/%s" % (base, elt_target)
    host_gcc = "%s/bin/%s-gcc" % (base, elt_target)

    if os.path.exists(host_tc) and os.path.exists(host_gcc):
        # Ubuntu host cross toolchain is installed on the host

        version = get_version(d, host_gcc)
        if "Ubuntu/Linaro" in version:
            #bb.note("Using Ubuntu host cross toolchain %s" % host_gcc)
            return True

    return False

# Evaluated a few times only initially and then self holding through
# the shadow variable, so not really performance critical
def toolchain_get_tcmode(d):
    tcmode = d.getVar("TCMODESHADOW", True)
    if tcmode:
        return tcmode

    tcmode = "default"
    if ubuntu_ext_toolchain(d) is True:
        tcmode = "external-linaro"
    bb.debug(1, "Dynamic toolchain selection for TCMODE selected %s" % tcmode)
    d.setVar("TCMODESHADOW", tcmode)
    return tcmode

# Evaluated a few times only initially and then self holding through
# the shadow variable, so not really performance critical
def toolchain_get_tclibc(d):
    tclibc = d.getVar("TCLIBCSHADOW", True)
    if tclibc:
        return tclibc

    tclibc = "glibc"
    if ubuntu_ext_toolchain(d) is True:
        tclibc = "external-linaro-toolchain"
    bb.debug(1, "Dynamic toolchain selection for TCLIBC selected %s" % tclibc)
    d.setVar("TCLIBCSHADOW", tclibc)
    return tclibc


# In case the Ubuntu toolchain is used, this event handler creates a wrapper
# for the the host toolchain, to shape it like a linaro-external-toolchain
# (e.g. toolchain install)
# The toolchain install is done in the ConfigParsed event handler, as this
# event is triggered before the toolchain is actually being used.
# This could have been done also in the ubuntu_ext_toolchain, but because that 
# function is called for every TCMODE/TCLIBC access, it is preffered to keep 
# it with minimal overhead

addhandler ubuntu_toolchain_setup
ubuntu_toolchain_setup[eventmask] = "bb.event.ConfigParsed"
python ubuntu_toolchain_setup () {
    d = e.data

    if ubuntu_ext_toolchain(d) is True:
        bb.build.exec_func("myshell_install_ext_toolchain", d)

    return
}
```
