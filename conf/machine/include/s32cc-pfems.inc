## conf/machine/include/s32cc-pfems.inc
```bitbake
# Copyright 2023 NXP

PFE_DT := "${KERNEL_DEVICETREE}"
PFEMS_DT := "${@d.getVar('KERNEL_DEVICETREE', True).replace('.dtb', '-pfems.dtb')}"
KERNEL_DEVICETREE ?= "${@bb.utils.contains('DISTRO_FEATURES', 'pfe-slave', '${PFEMS_DT}', '${PFE_DT}', d)}"
```

## conf/machine/include/s32cc.inc
```bitbake
require conf/machine/include/s32-base.inc

SOC_FAMILY:append = ":s32cc"

INIT_MANAGER ?= "systemd"

IMAGE_FSTYPES += "ext4"

BOOT_TYPE ?= "sdcard qspi"

# Specific definitions for .sdcard image generation
IMAGE_FSTYPES += "sdcard"
SDCARD_ROOTFS = "ext4"

UBOOT_SUFFIX_SDCARD = "${UBOOT_SUFFIX}"

UBOOT_ENV_SDCARD_OFFSET ?= "0x00280000"

# The following variable enables dynamic retrieval of FLASHIMAGE offsets from the Linux's device tree
FLASHIMAGE_DYNAMIC_OFFSETS ?= "1"

# Enable DM-Verity
require ${@bb.utils.contains('DISTRO_FEATURES', 'dm-verity', 'conf/machine/include/s32cc-dm-verity.inc', '', d)}

# When m7boot is enabled, the needed ATF settings are included from m7-boot.inc
require ${@bb.utils.contains('DISTRO_FEATURES', 'm7boot', 'conf/machine/include/m7-boot.inc', 'conf/machine/include/atf.inc', d)}
# Enable FIP Authentication
require ${@bb.utils.contains('DISTRO_FEATURES', 'secboot', 'conf/machine/include/hse-secboot.inc', '', d)}

# Check whether to switch from SIUL2 drivers to SCMI ones
SCMI_USE_SCMI_PINCTRL ??= "${@bb.utils.contains('DISTRO_FEATURES', 'scprt', '1', '0', d)}"
SCMI_USE_SCMI_GPIO ??= "${@bb.utils.contains('DISTRO_FEATURES', 'scprt', '1', '0', d)}"
SCMI_USE_SCMI_NVMEM ??= "0"
SCMI_DTB_NODE_CHANGE = "${@'true' if int(d.getVar('SCMI_USE_SCMI_PINCTRL')) or int(d.getVar('SCMI_USE_SCMI_GPIO')) or int(d.getVar('SCMI_USE_SCMI_NVMEM')) else 'false'}"

# Allow extensibility from other Yocto layers that define this include file
include conf/machine/include/s32cc-extra.inc
```

## conf/machine/include/s32g.inc
```bitbake
require conf/machine/include/s32cc-board.inc

KERNEL_DEFCONFIG ?= "s32cc_defconfig"

MACHINEOVERRIDES =. "s32g:"

UBOOT_CONFIG ?= "sdcard"
UBOOT_CONFIG[sdcard] = "${UBOOT_DEFCONFIG},,u-boot-nodtb.${UBOOT_SUFFIX}"

# prepend 'qspi' to keep the default deploy/u-boot-<MACHINE>.s32 to point to sdcard
UBOOT_CONFIG:prepend = "qspi "
UBOOT_CONFIG[qspi] = "${UBOOT_FLASH_DEFCONFIG},,u-boot-nodtb.${UBOOT_SUFFIX}"
```

## conf/machine/include/s32g2.inc
```bitbake
require conf/machine/include/s32-gen1-board.inc

KERNEL_DEFCONFIG ?= "s32gen1_defconfig"

MACHINEOVERRIDES =. "s32g2:"

UBOOT_CONFIG ?= "sdcard"
UBOOT_CONFIG[sdcard] = "${UBOOT_DEFCONFIG},,u-boot.${UBOOT_SUFFIX}"

# prepend 'qspi' to keep the default deploy/u-boot-<MACHINE>.s32 to point to sdcard
UBOOT_CONFIG_prepend = "qspi "
UBOOT_CONFIG[qspi] = "${UBOOT_FLASH_DEFCONFIG},,u-boot.${UBOOT_SUFFIX}"

# Enable ATF
require ${@bb.utils.contains('DISTRO_FEATURES', 'atf', 'conf/machine/include/atf.inc', '', d)}
```

## conf/machine/include/s32g2evb.inc
```bitbake
require conf/machine/include/s32g2.inc

MACHINEOVERRIDES =. "s32g2evb:"
MACHINEOVERRIDES =. "s32gevbx:"

ATF_PLAT = "s32g2xxaevb"

UBOOT_DEFCONFIG = "s32g2xxaevb_defconfig"
UBOOT_FLASH_DEFCONFIG = "s32g2xxaevb_qspi_defconfig"

KERNEL_DEVICETREE ??= "freescale/s32g2xxa-evb.dtb"
require conf/machine/include/s32cc-pfems.inc

FLASHIMAGE_DTB_FILE = "s32g2xxa-evb.${FLASHIMAGE_DTB_SUFFIX}"
```

## conf/machine/include/s32g2evb3.inc
```bitbake
require conf/machine/include/s32g2.inc

MACHINEOVERRIDES =. "s32g2evb3:"
MACHINEOVERRIDES =. "s32gevbx:"

ATF_PLAT = "s32g2xxaevb3"

UBOOT_DEFCONFIG = "s32g2xxaevb3_defconfig"
UBOOT_FLASH_DEFCONFIG = "s32g2xxaevb3_qspi_defconfig"

KERNEL_DEVICETREE ??= "freescale/s32g2xxa-evb3.dtb"
require conf/machine/include/s32cc-pfems.inc

FLASHIMAGE_DTB_FILE = "s32g2xxa-evb3.${FLASHIMAGE_DTB_SUFFIX}"
```

## conf/machine/include/s32g3evb.inc
```bitbake
require conf/machine/include/s32g3.inc

MACHINEOVERRIDES =. "s32g3evb:"
MACHINEOVERRIDES =. "s32gevbx:"

ATF_PLAT = "s32g3xxaevb"

UBOOT_DEFCONFIG = "s32g3xxaevb_defconfig"
UBOOT_FLASH_DEFCONFIG = "s32g3xxaevb_qspi_defconfig"

KERNEL_DEVICETREE ??= "freescale/s32g3xxa-evb.dtb"
require conf/machine/include/s32cc-pfems.inc

FLASHIMAGE_DTB_FILE = "s32g3xxa-evb.${FLASHIMAGE_DTB_SUFFIX}"
```

## conf/machine/include/s32g3evb3.inc
```bitbake
require conf/machine/include/s32g3.inc

MACHINEOVERRIDES =. "s32g3evb3:"
MACHINEOVERRIDES =. "s32gevbx:"

ATF_PLAT = "s32g3xxaevb3"

UBOOT_DEFCONFIG = "s32g3xxaevb3_defconfig"
UBOOT_FLASH_DEFCONFIG = "s32g3xxaevb3_qspi_defconfig"

KERNEL_DEVICETREE ??= "freescale/s32g3xxa-evb3.dtb"
require conf/machine/include/s32cc-pfems.inc

FLASHIMAGE_DTB_FILE = "s32g3xxa-evb3.${FLASHIMAGE_DTB_SUFFIX}"
```

## conf/machine/include/s32gen1flashmap.inc
```bitbake
# QSPI, similar to SD card mapping

# These should be kept in sync with 'u-boot/include/configs/s32.h'

FLASHIMAGE_UBOOT_OFFSET		= "0x00000000"
FLASHIMAGE_UBOOT_ENV_OFFSET	= "0x001e0000"
FLASHIMAGE_KERNEL_OFFSET	= "0x001f0000"
FLASHIMAGE_DTB_OFFSET		= "0x00ef0000"
FLASHIMAGE_ROOTFS_OFFSET	= "0x00ff0000"
FLASHIMAGE_PFE_OFFSET		= "0x03000000"
```

## conf/machine/include/s32v2flashmap.inc
```bitbake
# QSPI, similar to SD card mapping

FLASHIMAGE_UBOOT_OFFSET		= "0x00000000"
FLASHIMAGE_UBOOT_ENV_OFFSET	= "0x000c0000"
FLASHIMAGE_KERNEL_OFFSET	= "0x00100000"
FLASHIMAGE_DTB_OFFSET	        = "0x00E00000"
FLASHIMAGE_ROOTFS_OFFSET	= "0x00F00000"
```

## conf/machine/include/s32v2xx-base.inc
```bitbake
# Provides the common settings for S32V2xx

SOC_FAMILY = "s32v:s32v2xx"

require conf/machine/include/soc-family.inc
require conf/machine/include/arm/arch-arm64.inc

# S32V BSP default providers
PREFERRED_PROVIDER_u-boot ?= "u-boot-s32v2xx"
PREFERRED_PROVIDER_virtual/bootloader ?= "u-boot-s32v2xx"
PREFERRED_PROVIDER_virtual/kernel = "linux-s32v2xx"

KERNEL_IMAGETYPE ?= "Image"

UBOOT_MACHINE_SDCARD ?= "${MACHINE}"
UBOOT_MACHINE ?= "${MACHINE}_config"

#s32v has no hardware clock
MACHINE_FEATURES_BACKFILL_CONSIDERED = "rtc"

MACHINE_FEATURES = "pci ext2 ext2 serial"
MACHINE_EXTRA_RRECOMMENDS = "udev-extraconf"

# We want to be on the safe side
BBMASK_append = "|.*llvm2.8|.*llvm2.9"

# We also want to permit SD card image generation
# This sets up the defaults, just in case the image
# specifies an addition of "sdcard" to IMAGE_FSTYPES
# Due to some limitations, we can't just use
# image_types_fsl but have to duplicate it mostly.
IMAGE_CLASSES += "image_types_fsl_sdcard"

#Fix warning for ITS file 
KERNEL_ITS_FILE ?= "."

# Add mirrors for linaro urls
LINARO_URL = "https?://releases.linaro.org/${MMYY}/"
LINARO_ARCHIVE_URL = "https://releases.linaro.org/archive/${MMYY}/"
LINARO_SNAPSHOT_URL = "https://snapshots.linaro.org/openembedded/sources/"
ABE_URL = "http://148.251.136.42/snapshots-ref/"

MIRRORS += " \
        ${LINARO_URL} ${LINARO_ARCHIVE_URL} \n \
        ${LINARO_URL}.* ${LINARO_SNAPSHOT_URL} \n \
        ${LINARO_URL}.* ${ABE_URL} \n \
"

# Include downloads folder
FSL_LOCAL_MIRROR ?= "file://${TOPDIR}/../downloads"

# Specific jpeg package
PREFERRED_PROVIDER_jpeg = "libjpeg-turbo"
PREFERRED_PROVIDER_jpeg-native = "libjpeg-turbo-native"

# Using gdb 7.11.1
GDBVERSION_s32v2xx = "7.11.1"
```

## conf/machine/include/s32v2xx.inc
```bitbake
require conf/machine/include/s32-base.inc

SOC_FAMILY_append = ":s32v:s32v2xx"

UBOOT_SUFFIX ?= "s32"

IMAGE_FSTYPES += "ext4"

# Specific definitions for .sdcard image generation
IMAGE_FSTYPES += "sdcard"
SDCARD_ROOTFS = "ext4"
UBOOT_SUFFIX_SDCARD = "${UBOOT_SUFFIX}"
IMAGE_CLASSES += "image_types_fsl_sdcard"

# Permit later to optionally add flashimage to IMAGE_FSTYPES
IMAGE_CLASSES += "image_types_fsl_flashimage"

UBOOT_CONFIG ?= "sdcard"
UBOOT_CONFIG[sdcard] ?= "${MACHINE}_config,,u-boot.${UBOOT_SUFFIX}"

# Setting the following variable disables the AVB TX queues (1 and 2) on S32V234 
# to prevent a FEC TX queue timeout that occurs when using NFS root filesystem.
# This issue occurs on S32V234 and we enable it by default for this platform
# for safety.
# The limitation can be disabled by setting it to 0 in local.conf.
KERNEL_FEC_LIMIT_TX ?= "1"

# On S32V, we support either pure SW rendering or HW assisted
# rendering. Libraries come from different sources then.
PREFERRED_PROVIDER_virtual/egl = "${@bb.utils.contains("DISTRO_FEATURES", "gpu", "gpu-viv-bin-s32v2xx", "mesa", d)}"
PREFERRED_PROVIDER_virtual/libgles1 = "${@bb.utils.contains("DISTRO_FEATURES", "gpu", "gpu-viv-bin-s32v2xx", "mesa", d)}"
PREFERRED_PROVIDER_virtual/libgles2 = "${@bb.utils.contains("DISTRO_FEATURES", "gpu", "gpu-viv-bin-s32v2xx", "mesa", d)}"

KERNEL_NAME = "${PREFERRED_PROVIDER_virtual/kernel}"
KERNEL_VER = '${@d.getVar("PREFERRED_VERSION_${KERNEL_NAME}",True)}'
PREFERRED_VERSION_kernel-module-galcore = "${@oe.utils.conditional('KERNEL_VER', '5.4', '6.4.0', '6.2.4', d)}"
```

## conf/machine/include/set_insane_skip.inc
```bitbake
def set_insane_skip(d):
	packagelist = (d.getVar('INSANE_SKIP_LIST', True) or '').split()
	for p in packagelist:
		crt = d.getVar('INSANE_SKIP_' + p, True)
		if not crt:
			crt = " "
		d.setVar('INSANE_SKIP_' + p, crt + INSANE_SKIP_VALUE)


addhandler set_insane_skip_handler
set_insane_skip_handler[eventmask] = "bb.event.ConfigParsed"
python set_insane_skip_handler () {
	d = e.data

	set_insane_skip(d)

	return
}
```
