## conf/machine/ls1012abluebox.conf
```bitbake
#@TYPE: Machine
#@NAME: Freescale LS1012ARDB in BlueBox configuration
#@SOC: LSCH1
#@DESCRIPTION: Machine configuration for running LS1012A in BlueBox configuration
#@MAINTAINER: Heinz Wrobel <Heinz.Wrobel@nxp.com>

require conf/machine/ls1012ardb.conf

IMAGE_FSTYPES += "ext3"
EXTRA_IMAGECMD_ext3 = "-i 4096 -L ${IMAGE_NAME}"

EXTRA_IMAGEDEPENDS_remove = "uefi"
MACHINEBASELINE = "ls1012ardb"

IMAGE_CLASSES += "image_types_fsl_flashimage"

# On the LS1012ARDB we have a 64MB QSPI flash. Bank 4 support is really
# a second flash and only one is visible at a given time.
FLASHIMAGE_RCW = "R_SPNH_3508/PBL_0x35_0x08_800_250_1000_default.bin"

FLASHIMAGE_UBOOT_TYPE = "qspi"

require include/lsflashmap.inc
FLASHIMAGE_SIZE = "64"
FLASHIMAGE_BANK4 = "no"
FLASHIMAGE_RESET = "rcw"
FLASHIMAGE_RESET_FILE = "rcw/${MACHINEBASELINE}/${FLASHIMAGE_RCW}"
FLASHIMAGE_ROOTFS_SUFFIX = "itb"
FLASHIMAGE_EXTRA1 = "u-boot-environment"
FLASHIMAGE_EXTRA1_FILE = "u-boot-flashenv-${MACHINE}.bin"
FLASHIMAGE_EXTRA1_OFFSET = "${FLASHIMAGE_UBOOT_ENV_OFFSET}"
FLASHIMAGE_EXTRA4 = "ppa"
FLASHIMAGE_EXTRA4_FILE = "ppa.itb"
FLASHIMAGE_EXTRA4_OFFSET = "${FLASHIMAGE_PPA_OFFSET}"
```

## conf/machine/ls1043abluebox.conf
```bitbake
#@TYPE: Machine
#@NAME: Freescale LS1043ARDB in BlueBox configuration
#@SOC: LSCH1
#@DESCRIPTION: Machine configuration for running LS1043A in BlueBox configuration
#@MAINTAINER: Heinz Wrobel <Heinz.Wrobel@nxp.com>

require conf/machine/ls1043ardb.conf

IMAGE_FSTYPES += "ext4"
EXTRA_IMAGECMD_ext4 = "-i 4096 -L ${IMAGE_NAME}"

# We also want to permit SD card image generation
# This sets up the defaults, just in case the image
# specifies an addition of "sdcard" to IMAGE_FSTYPES
# Due to some limitations, we can't just use
# image_types_fsl but have to duplicate it mostly.
IMAGE_CLASSES += "image_types_fsl_sdcard"

# An ugly trick to keep using image_types_fsl_itb class for now
KERNEL_DEVICETREE = "freescale/fsl-ls1043a-rdb.dtb"
KERNEL_DEVICETREE_remove_use-nxp-bsp = "\
    freescale/fsl-ls1043a-rdb-sdk.dtb \
    freescale/fsl-ls1043a-rdb-usdpaa.dtb \
    freescale/fsl-ls1043a-qds-sdk.dtb \
"

EXTRA_IMAGEDEPENDS_remove = "uefi"

# On the LS1 we have a 128MB NOR flash and Bank 4 support
require include/lxflashmap.inc
FLASHIMAGE_SIZE = "128"
FLASHIMAGE_BANK4 = "yes"
FLASHIMAGE_RESET = "atf"
FLASHIMAGE_RESET_FILE = "atf/bl2_nor.pbl"
FLASHIMAGE_EXTRA9 = "linux-kernelitb"
FLASHIMAGE_EXTRA9_FILE = "kernel-withrootfs.itb"
FLASHIMAGE_EXTRA9_OFFSET = "${FLASHIMAGE_KERNEL_OFFSET}"
FLASHIMAGE_EXTRA1 = "u-boot-environment"
FLASHIMAGE_EXTRA1_FILE = "u-boot-flashenv-${MACHINE}.bin"
FLASHIMAGE_EXTRA1_OFFSET = "${FLASHIMAGE_UBOOT_ENV_OFFSET}"
FLASHIMAGE_EXTRA2 = "fm-ucode"
FLASHIMAGE_EXTRA2_FILE = "fsl_fman_ucode_ls1043_r1.1_106_4_18.bin"
FLASHIMAGE_EXTRA2_OFFSET = "${FLASHIMAGE_DPAA1_FMAN_OFFSET}"
#FLASHIMAGE_EXTRA3 = "uefi"
#FLASHIMAGE_EXTRA3_FILE = ""
#FLASHIMAGE_EXTRA3_OFFSET = "${FLASHIMAGE_UEFI_DTB_OFFSET}"
FLASHIMAGE_EXTRA5 = "qe-ucode"
FLASHIMAGE_EXTRA5_FILE = "boot/${QE_UCODE}"
FLASHIMAGE_EXTRA5_OFFSET = "${FLASHIMAGE_QE_OFFSET}"

FLASHIMAGE_UBOOT = "atf"
FLASHIMAGE_UBOOT_FILE = "atf/fip_uboot.bin"

# Generating an SDHC image to be directly booted with RCW=0x40
SDCARD_RCW = "atf"
SDCARD_RCW_NAME = "atf/bl2_sd.pbl"

SDCARD_BINARY_SPACE = "65536"
UBOOT_NAME_SDCARD = "atf/fip_uboot.bin"
UBOOT_BOOTSPACE_OFFSET  = "${FLASHIMAGE_UBOOT_OFFSET}"
SDCARD_ROOTFS ?= "ext4"
BOOT_SPACE ?= "16384"

IMAGE_FSTYPES += "sdcard"
```

## conf/machine/ls1046abluebox.conf
```bitbake
#@TYPE: Machine
#@NAME: Freescale LS1046ARDB in BlueBox configuration
#@SOC: LSCH1
#@DESCRIPTION: Machine configuration for running LS1046A in BlueBox configuration
#@MAINTAINER: Heinz Wrobel <Heinz.Wrobel@nxp.com>

require conf/machine/ls1046ardb.conf
require conf/machine/include/qoriq-atf.inc
require conf/machine/include/qoriq-common.inc

IMAGE_FSTYPES += "ext4"
EXTRA_IMAGECMD:ext4 = "-i 4096 -L ${IMAGE_NAME}"

DTB_LOAD = "0x90000000"
UBOOT_ENTRYPOINT = "0x80200000"

UBOOT_ENV_INC_NAME:append = " distro_boot"

EXTRA_IMAGEDEPENDS:remove = "uefi"

# On the LS1046ARDB we have 2*64MB QSPI flash. Bank 4 support is really
# a second flash and only one is visible at a given time.
# Given modern kernel sizes, we do not use virtual/kernel but a
# size reduced version suitable for a recovery Linux in flash.
require include/lxflashmap.inc
FLASHIMAGE_KERNEL = "linux-flash"
FLASHIMAGE_KERNEL_BASENAME = "kernel-flash"
FLASHIMAGE_SIZE = "64"
FLASHIMAGE_BANK4 = "no"
FLASHIMAGE_RESET = "${ATF}"
FLASHIMAGE_RESET_FILE = "${ATF_RESET_FILE_QSPI}"
FLASHIMAGE_EXTRA9 = "linux-kernelitb"
FLASHIMAGE_EXTRA9_FILE = "kernel-flash-withrootfs.itb"
FLASHIMAGE_EXTRA9_OFFSET = "${FLASHIMAGE_KERNEL_OFFSET}"
FLASHIMAGE_EXTRA1 = "u-boot-environment"
FLASHIMAGE_EXTRA1_FILE = "u-boot-flashenv-${MACHINE}.bin"
FLASHIMAGE_EXTRA1_OFFSET = "${FLASHIMAGE_UBOOT_ENV_OFFSET}"
FLASHIMAGE_EXTRA2 = "fm-ucode"
FLASHIMAGE_EXTRA2_FILE = "fsl_fman_ucode_ls1046_r1.0_106_4_18.bin"
FLASHIMAGE_EXTRA2_OFFSET = "${FLASHIMAGE_DPAA1_FMAN_OFFSET}"

FLASHIMAGE_UBOOT = "${ATF}"
FLASHIMAGE_UBOOT_FILE = "${ATF_IMAGE_FILE_QSPI}"

# Generating an SDHC image to be directly booted with RCW=0x40
SDCARD_RCW = "${ATF}"
SDCARD_RCW_NAME = "${ATF_RESET_FILE_SD}"

SDCARD_BINARY_SPACE = "65536"
UBOOT_NAME_SDCARD = "${ATF_IMAGE_FILE_SD}"
UBOOT_BOOTSPACE_OFFSET  = "${FLASHIMAGE_UBOOT_OFFSET}"
SDCARD_ROOTFS ?= "ext4"
BOOT_SPACE ?= "65536"

# No emergency Ubuntu Linux on the SD card as flash like element,
# so we disable inheritance from above by explicitly clearing it.
SDCARDIMAGE_EXTRA9_FILE:ubuntu = ""

IMAGE_FSTYPES += "sdcard"
```

## conf/machine/ls1046ablueboxubuntu.conf
```bitbake
# The Ubuntu version of the conf file just resets to the normal conf
# file name, so that we do not have to change compatibility settings
# all over the place.
# <Heinz.Wrobel@nxp.com>
MACHINE="ls1046abluebox"

require conf/machine/ls1046abluebox.conf
require conf/machine/include/ubuntubasics.inc
```

## conf/machine/ls2080abluebox.conf
```bitbake
#@TYPE: Machine
#@NAME: NXP LS2080A BlueBox
#@SOC: LSCH3
#@DESCRIPTION: Machine configuration for LS2080A in the BlueBox
#@MAINTAINER: Heinz Wrobel <Heinz.Wrobel@nxp.com>

require ls2084abluebox.conf

# Names are slightly different for the older LS2080
RCWNOR = "FFFFPPHH_0x2a_0x41/rcw_ffffpphh_0x2a_0x41_1800_500_1867ddr"
SOC_FAMILY_prepend = "ls2080a:"
```

## conf/machine/ls2084abbmini.conf
```bitbake
#@TYPE: Machine
#@NAME: NXP BlueBox Mini
#@SOC: LSCH3
#@DESCRIPTION: Machine configuration for the BlueBox Mini
#@MAINTAINER: Heinz Wrobel <Heinz.Wrobel@nxp.com>

require conf/machine/include/ls208xa-base.inc

SOC_FAMILY:prepend = "ls2084a:"

MACHINE_FEATURES += "optee"

RCWNOR ?= "FFFFPPHH_0x2a_0x41/rcw_ffffpphh_0x2a_0x41_1800_700_1867_1600"
RCWSD ?= "${@bb.utils.contains('DISTRO_FEATURES', 'ls2-pcie-ep', \
       'FFFFPPHH_0x2a_0x41/rcw_ffffpphh_0x2a_0x41_SDHC_EPGen2_1800_700_1867_1600', \
       'FFFFPPHH_0x2a_0x41/rcw_ffffpphh_0x2a_0x41_SDHC_1800_700_1867_1600', d)}"

UBOOT_CONFIG ??= "tfa"
UBOOT_CONFIG[tfa] = "${MACHINE}_tfa_defconfig,,u-boot-dtb.bin"

# For the factory image, we support a special environment
UBOOT_ENV_NAME:append:ls2084abbmini = " u-boot-flashenv-factory"

UBOOT_ENV_INC_NAME:append:fsl-lsch3 = " distro_boot"

KERNEL_DEVICETREE ?= "freescale/fsl-ls2084a-bbmini.dtb"
KERNEL_DEFCONFIG ?= "defconfig"

SERIAL_CONSOLES ?= "115200;ttyS0 115200;ttyS1"
SERIAL_CONSOLES_CHECK ?= "${SERIAL_CONSOLES}"

MACHINE_EXTRA_RRECOMMENDS = ""

USE_VT = "0"

# On the BlueBox we have a 128MB NOR flash for LS2 and Bank 4 support.
# Given modern kernel sizes, we do not use virtual/kernel but a
# size reduced version suitable for a recovery Linux in flash.
require include/lxflashmap.inc
FLASHIMAGE_KERNEL = "linux-flash"
FLASHIMAGE_KERNEL_BASENAME = "kernel-flash"
FLASHIMAGE_SIZE = "128"
FLASHIMAGE_BANK4 = "yes"
FLASHIMAGE_RESET = "${ATF}"
FLASHIMAGE_RESET_FILE = "${ATF_RESET_FILE_NOR}"
FLASHIMAGE_EXTRA9 = "linux-kernelitb"
FLASHIMAGE_EXTRA9_FILE = "kernel-flash-withrootfs.itb"
FLASHIMAGE_EXTRA9_OFFSET = "${FLASHIMAGE_KERNEL_OFFSET}"
FLASHIMAGE_EXTRA1 = "management-complex"
FLASHIMAGE_EXTRA1_FILE = "mc_app/mc.itb"
FLASHIMAGE_EXTRA1_OFFSET = "${FLASHIMAGE_DPAA2_MC_OFFSET}"
FLASHIMAGE_EXTRA2 = "mc-utils"
FLASHIMAGE_EXTRA2_FILE = "mc-utils/custom/${MACHINE}-dpl-ethbluebox.0x2A_0x41.dtb"
FLASHIMAGE_EXTRA2_OFFSET = "${FLASHIMAGE_DPAA2_DPL_OFFSET}"
FLASHIMAGE_EXTRA3 = "mc-utils"
FLASHIMAGE_EXTRA3_FILE = "mc-utils/custom/${MACHINE}-dpc-0x2a41.dtb"
FLASHIMAGE_EXTRA3_OFFSET = "${FLASHIMAGE_DPAA2_DPC_OFFSET}"
FLASHIMAGE_EXTRA4 = "u-boot-environment"
FLASHIMAGE_EXTRA4_FILE = "u-boot-flashenv-${MACHINE}.bin"
FLASHIMAGE_EXTRA4_OFFSET = "${FLASHIMAGE_UBOOT_ENV_OFFSET}"
FLASHIMAGE_UBOOT = "${ATF}"
FLASHIMAGE_UBOOT_FILE = "${ATF_IMAGE_FILE_NOR}"

# Generating an SDHC image to be directly booted with RCW=0x40
SDCARD_RCW = "${ATF}"
SDCARD_RCW_NAME = "${ATF_RESET_FILE_SD}"

SDCARD_BINARY_SPACE = "65536"
UBOOT_NAME_SDCARD = "${ATF_IMAGE_FILE_SD}"
UBOOT_BOOTSPACE_OFFSET  = "${FLASHIMAGE_UBOOT_OFFSET}"
BOOT_SPACE ?= "65536"

# No emergency Ubuntu Linux on the SD card as flash like element,
# so we disable inheritance from above by explicitly clearing it.
SDCARDIMAGE_EXTRA9_FILE:ubuntu = ""

IMAGE_FSTYPES += "sdcard"
```

## conf/machine/ls2084abbminiubuntu.conf
```bitbake
#@TYPE: Machine
#@NAME: NXP BlueBox Mini with Ubuntu rootfs
#@SOC: LSCH3
#@DESCRIPTION: Machine configuration for the BlueBox Mini for Ubuntu
#@MAINTAINER: Heinz Wrobel <Heinz.Wrobel@nxp.com>

# The Ubuntu version of the conf file just resets to the normal conf
# file name, so that we do not have to change compatibility settings
# all over the place.
# <Heinz.Wrobel@nxp.com>
MACHINE="ls2084abbmini"
require conf/machine/ls2084abbmini.conf

require conf/machine/include/ubuntubasics.inc
```

## conf/machine/ls2084abluebox.conf
```bitbake
#@TYPE: Machine
#@NAME: NXP LS2084A BlueBox
#@SOC: LSCH3
#@DESCRIPTION: Machine configuration for LS2084A in the BlueBox
#@MAINTAINER: Heinz Wrobel <Heinz.Wrobel@nxp.com>

require conf/machine/include/ls208xa-base.inc

SOC_FAMILY:prepend:ls2084abluebox = "ls2084a:"

MACHINE_FEATURES += "optee"

RCWNOR = "${@bb.utils.contains('DISTRO_FEATURES', 'ls2-pcie-ep', \
	'FFFFPPHH_0x2a_0x41/rcw_ffffpphh_0x2a_0x41_EPGen2_1800_700_1867_1600', \
	'FFFFPPHH_0x2a_0x41/rcw_ffffpphh_0x2a_0x41_1800_700_1867_1600', d)}"

UBOOT_CONFIG ??= "tfa"
UBOOT_CONFIG[tfa] = "${MACHINE}_tfa_defconfig,,u-boot-dtb.bin"

UBOOT_ENV_INC_NAME:append:fsl-lsch3 = " distro_boot"

KERNEL_DEVICETREE ?= "freescale/fsl-ls2084a-bluebox.dtb"
KERNEL_DEFCONFIG ?= "defconfig"

SERIAL_CONSOLES ?= "115200;ttyS0 115200;ttyS1"
SERIAL_CONSOLES_CHECK ?= "${SERIAL_CONSOLES}"

MACHINE_EXTRA_RRECOMMENDS = ""

USE_VT = "0"

# On the BlueBox we have a 128MB NOR flash for LS2 and Bank 4 support.
# Given modern kernel sizes, we do not use virtual/kernel but a
# size reduced version suitable for a recovery Linux in flash.
require include/lxflashmap.inc
FLASHIMAGE_KERNEL = "linux-flash"
FLASHIMAGE_KERNEL_BASENAME = "kernel-flash"
FLASHIMAGE_SIZE = "128"
FLASHIMAGE_BANK4 = "yes"
FLASHIMAGE_RESET = "${ATF}"
FLASHIMAGE_RESET_FILE = "${ATF_RESET_FILE_NOR}"
FLASHIMAGE_EXTRA9 = "linux-kernelitb"
FLASHIMAGE_EXTRA9_FILE = "kernel-flash-withrootfs.itb"
FLASHIMAGE_EXTRA9_OFFSET = "${FLASHIMAGE_KERNEL_OFFSET}"
FLASHIMAGE_EXTRA1 = "management-complex"
FLASHIMAGE_EXTRA1_FILE = "mc_app/mc.itb"
FLASHIMAGE_EXTRA1_OFFSET = "${FLASHIMAGE_DPAA2_MC_OFFSET}"
FLASHIMAGE_EXTRA2 = "mc-utils"
FLASHIMAGE_EXTRA2_FILE = "mc-utils/custom/${MACHINE}-dpl-ethbluebox.0x2A_0x41.dtb"
FLASHIMAGE_EXTRA2_OFFSET = "${FLASHIMAGE_DPAA2_DPL_OFFSET}"
FLASHIMAGE_EXTRA3 = "mc-utils"
FLASHIMAGE_EXTRA3_FILE = "mc-utils/custom/${MACHINE}-dpc-0x2a41.dtb"
FLASHIMAGE_EXTRA3_OFFSET = "${FLASHIMAGE_DPAA2_DPC_OFFSET}"
FLASHIMAGE_EXTRA4 = "u-boot-environment"
FLASHIMAGE_EXTRA4_FILE = "u-boot-flashenv-${MACHINE}.bin"
FLASHIMAGE_EXTRA4_OFFSET = "${FLASHIMAGE_UBOOT_ENV_OFFSET}"
FLASHIMAGE_EXTRA5 = "ls2-phy"
FLASHIMAGE_EXTRA5_FILE = "ls2-phy/cs4315-cs4340-PHY-ucode.txt"
FLASHIMAGE_EXTRA5_OFFSET = "${FLASHIMAGE_ETHPHY_OFFSET}"
FLASHIMAGE_UBOOT = "${ATF}"
FLASHIMAGE_UBOOT_FILE = "${ATF_IMAGE_FILE_NOR}"
```

## conf/machine/ls2084ablueboxubuntu.conf
```bitbake
#@TYPE: Machine
#@NAME: NXP BlueBox Classic with Ubuntu rootfs
#@SOC: LSCH3
#@DESCRIPTION: Machine configuration for the BlueBox Classic for Ubuntu
#@MAINTAINER: Heinz Wrobel <Heinz.Wrobel@nxp.com>

# The Ubuntu version of the conf file just resets to the normal conf
# file name, so that we do not have to change compatibility settings
# all over the place.
# <Heinz.Wrobel@nxp.com>
MACHINE="ls2084abluebox"
require conf/machine/ls2084abluebox.conf

require conf/machine/include/ubuntubasics.inc
```
