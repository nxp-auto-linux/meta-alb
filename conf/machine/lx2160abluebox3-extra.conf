## conf/machine/lx2160abluebox3-extra.conf
```bitbake
# This config fragment is meant to patch the file
# lx2160abluebox3.conf from meta-qoriq

IMAGE_FSTYPES = "tar.gz ext4"

# required for sdcard deploy
HOSTTOOLS += "parted mkfs.vfat mcopy udevadm"

EXTRA_IMAGECMD_ext4 = "-i 4096 -L ${IMAGE_NAME}"

# We also want to permit SD card image generation.
# This sets up the defaults, just in case the image
# specifies an addition of "sdcard" to IMAGE_FSTYPES.
# Note that we can not boot U-Boot from SD Card on BB Classic
IMAGE_CLASSES += "image_types_fsl_sdcard"
SDCARD_ROOTFS ?= "ext4"
UBOOT_SUFFIX_SDCARD ?= "${UBOOT_SUFFIX}"

# 64 MB boot partition
BOOT_SPACE ?= "65536"

# Other types of images
IMAGE_CLASSES += "image_types_fsl_itb image_types_fsl_flashimage"

# Deploy rootfs type for bluebox images
IMAGE_ROOTFS_DEP_EXT ?= "ext4"

MACHINE_EXTRA_RRECOMMENDS = ""

USE_VT = "0"

PREFERRED_VERSION_tcpreplay = "4.3.3"
PREFERRED_VERSION_dpdk = "19.11-20.04"

# QSPI bank 4 support is done in HW. There is no need to duplicate
# the image within a single flash.
require include/lxflashmap.inc
FLASHIMAGE_SIZE = "64"
FLASHIMAGE_BANK4 = "no"
FLASHIMAGE_RESET = "atf"
FLASHIMAGE_RESET_FILE = "atf/bl2_flexspi_nor.pbl"
FLASHIMAGE_EXTRA9 ?= "linux-kernelitb"
FLASHIMAGE_EXTRA9_FILE ?= "kernel-withrootfs.itb"
FLASHIMAGE_EXTRA9_OFFSET ?= "${FLASHIMAGE_KERNEL_OFFSET}"
FLASHIMAGE_EXTRA1 = "management-complex"
FLASHIMAGE_EXTRA1_FILE = "mc_app/mc.itb"
FLASHIMAGE_EXTRA1_OFFSET = "${FLASHIMAGE_DPAA2_MC_OFFSET}"
FLASHIMAGE_EXTRA2 = "mc-utils"
FLASHIMAGE_EXTRA2_FILE = "mc-utils/dpl-eth.31.dtb"
FLASHIMAGE_EXTRA2_OFFSET = "${FLASHIMAGE_DPAA2_DPL_OFFSET}"
FLASHIMAGE_EXTRA3 = "mc-utils"
FLASHIMAGE_EXTRA3_FILE = "mc-utils/dpc_31.dtb"
FLASHIMAGE_EXTRA3_OFFSET = "${FLASHIMAGE_DPAA2_DPC_OFFSET}"
FLASHIMAGE_EXTRA4 = "u-boot-environment"
FLASHIMAGE_EXTRA4_FILE = "u-boot-flashenv-${MACHINE}.bin"
FLASHIMAGE_EXTRA4_OFFSET = "${FLASHIMAGE_UBOOT_ENV_OFFSET}"
FLASHIMAGE_EXTRA5 = "ddr-phy"
FLASHIMAGE_EXTRA5_FILE = "ddr-phy/fip_ddr_all.bin"
FLASHIMAGE_EXTRA5_OFFSET = "${FLASHIMAGE_DDR_PHY_OFFSET}"
FLASHIMAGE_UBOOT = "atf"
FLASHIMAGE_UBOOT_FILE = "atf/fip_uboot.bin"

# Generating an SDHC image to be directly booted with RCW=0x40
SDCARD_RCW = "atf"
SDCARD_RCW_NAME = "atf/bl2_sd.pbl"

SDCARD_BINARY_SPACE = "65536"
UBOOT_NAME_SDCARD = "atf/fip_uboot.bin"
SDCARDIMAGE_EXTRA4_FILE = "u-boot-flashenv-sd-${MACHINE}.bin"
UBOOT_BOOTSPACE_OFFSET  = "${FLASHIMAGE_UBOOT_OFFSET}"
# Currently we only use the SDCard environment.
# For Flash/factory images we may want to use 'u-boot-flashenv' or
# one derived from it.
UBOOT_ENV_NAME = "u-boot-flashenv-sd"

IMAGE_FSTYPES += "sdcard"
```

## conf/machine/lx2160abluebox3.conf
```bitbake
#@TYPE: Machine
#@NAME: NXP LX2160ABLUEBOX3
#@SOC: LSCH3
#@DESCRIPTION: Machine configuration for running LX2160ABLUEBOX3 in 64-bit mode
#@MAINTAINER: Heinz Wrobel <heinz.wrobel@nxp.com>

require conf/machine/include/qoriq-atf.inc
require conf/machine/include/qoriq-common.inc
require conf/machine/include/qoriq-arm64.inc
require conf/machine/include/arm/arch-arm64.inc

MACHINEOVERRIDES =. "fsl-lsch3:lx2160a:"
# required for sdcard deploy
HOSTTOOLS += "parted mkfs.vfat mcopy"

IMAGE_FSTYPES += "ext4"
EXTRA_IMAGECMD:ext4 = "-i 4096 -L ${IMAGE_NAME}"

# We also want to permit SD card image generation.
# This sets up the defaults, just in case the image
# specifies an addition of "sdcard" to IMAGE_FSTYPES.
# Note that we can not boot U-Boot from SD Card on BB Classic
SDCARD_ROOTFS ?= "ext4"
UBOOT_SUFFIX_SDCARD ?= "${UBOOT_SUFFIX}"

MACHINE_FEATURES += "optee"

#KERNEL_CLASSES  = " kernel-fitimage "
#KERNEL_IMAGETYPES = "fitImage"

DTB_LOAD = "0x90000000"
UBOOT_ENTRYPOINT = "0x80200000"

UBOOT_CONFIG ??= "tfa-secure-boot tfa"
UBOOT_CONFIG[tfa] = "${MACHINE}_tfa_defconfig,,u-boot-dtb.bin"
UBOOT_CONFIG[tfa-secure-boot] = "${MACHINE}_tfa_SECURE_BOOT_defconfig,,u-boot-dtb.bin"

UBOOT_ENV_INC_NAME:append:fsl-lsch3 = " distro_boot"

KERNEL_DEVICETREE ?= "freescale/fsl-lx2160a-bluebox3.dtb"
KERNEL_DEFCONFIG ?= "defconfig"

RCWXSPI ?= "PPUUPPUU_PP_RR_31_2_2/rcw_2200_750_3200_xspi_31_2_2"
RCWSD ?= "PPUUPPUU_PP_RR_31_2_2/rcw_2200_750_3200_sd_31_2_2"
RCWEMMC ?= "PPUUPPUU_PP_RR_31_2_2/rcw_2200_750_3200_sd_31_2_2"

EXTRA_IMAGEDEPENDS += "management-complex mc-utils rcw ddr-phy ${ATF}"
USE_VT = "0"

# Given modern kernel sizes, we do not use virtual/kernel but a
# size reduced version suitable for a recovery Linux in flash.
require include/lxflashmap.inc
FLASHIMAGE_KERNEL = "linux-flash"
FLASHIMAGE_KERNEL_BASENAME = "kernel-flash"
# QSPI bank 4 support is done in HW. There is no need to duplicate
# the image within a single flash.
FLASHIMAGE_SIZE = "64"
FLASHIMAGE_BANK4 = "no"
FLASHIMAGE_RESET = "${ATF}"
FLASHIMAGE_RESET_FILE = "${ATF_RESET_FILE_XSPI}"
FLASHIMAGE_EXTRA9 ?= "linux-kernelitb"
FLASHIMAGE_EXTRA9_FILE ?= "kernel-flash-withrootfs.itb"
FLASHIMAGE_EXTRA9_OFFSET ?= "${FLASHIMAGE_KERNEL_OFFSET}"
FLASHIMAGE_EXTRA1 = "management-complex"
FLASHIMAGE_EXTRA1_FILE = "mc_app/mc.itb"
FLASHIMAGE_EXTRA1_OFFSET = "${FLASHIMAGE_DPAA2_MC_OFFSET}"
FLASHIMAGE_EXTRA2 = "mc-utils"
FLASHIMAGE_EXTRA2_FILE = "mc-utils/custom/${MACHINE}-dpl-ethbluebox.31.dtb"
FLASHIMAGE_EXTRA2_OFFSET = "${FLASHIMAGE_DPAA2_DPL_OFFSET}"
FLASHIMAGE_EXTRA3 = "mc-utils"
FLASHIMAGE_EXTRA3_FILE = "mc-utils/custom/${MACHINE}-dpc-31.dtb"
FLASHIMAGE_EXTRA3_OFFSET = "${FLASHIMAGE_DPAA2_DPC_OFFSET}"
FLASHIMAGE_EXTRA4 = "u-boot-environment"
FLASHIMAGE_EXTRA4_FILE = "u-boot-flashenv-${MACHINE}.bin"
FLASHIMAGE_EXTRA4_OFFSET = "${FLASHIMAGE_UBOOT_ENV_OFFSET}"
FLASHIMAGE_EXTRA5 = "ddr-phy"
FLASHIMAGE_EXTRA5_FILE = "ddr-phy/fip_ddr_all.bin"
FLASHIMAGE_EXTRA5_OFFSET = "${FLASHIMAGE_DDR_PHY_OFFSET}"

FLASHIMAGE_UBOOT = "${ATF}"
FLASHIMAGE_UBOOT_FILE = "${ATF_IMAGE_FILE_XSPI}"

# Generating an SDHC image to be directly booted with RCW=0x40
SDCARD_RCW = "${ATF}"
SDCARD_RCW_NAME = "${ATF_RESET_FILE_SD}"

SDCARD_BINARY_SPACE = "65536"
UBOOT_NAME_SDCARD = "${ATF_IMAGE_FILE_SD}"
SDCARDIMAGE_EXTRA4_FILE = "u-boot-flashenv-sd-${MACHINE}.bin"
UBOOT_BOOTSPACE_OFFSET  = "${FLASHIMAGE_UBOOT_OFFSET}"
BOOT_SPACE ?= "65536"
# Currently we only use the SDCard environment.
# For Flash/factory images we may want to use 'u-boot-flashenv' or
# one derived from it.
UBOOT_ENV_NAME:append = " u-boot-flashenv-sd"

# No emergency Ubuntu Linux on the SD card as flash like element,
# so we disable inheritance from above by explicitly clearing it.
# We also clear it for boot flash.
FLASHIMAGE_EXTRA9_FILE:ubuntu = ""
SDCARDIMAGE_EXTRA9_FILE:ubuntu = ""

IMAGE_FSTYPES += "sdcard"
```

## conf/machine/lx2160abluebox3ubuntu.conf
```bitbake
# The Ubuntu version of the conf file just resets to the normal conf
# file name, so that we do not have to change compatibility settings
# all over the place.
# <Heinz.Wrobel@nxp.com>
MACHINE="lx2160abluebox3"

require conf/machine/lx2160abluebox3.conf
require conf/machine/include/ubuntubasics.inc

# not required for ubuntu
IMAGE_CLASSES_remove += "image_types_fsl_flashimage"
IMAGE_FSTYPES_remove += "flashimage"

FLASHIMAGE_EXTRA9 = "linux-kernelitb-norootfs"
FLASHIMAGE_EXTRA9_FILE = "kernel.itb"
FLASHIMAGE_EXTRA9_OFFSET = "${FLASHIMAGE_ROOTFS_OFFSET}"
```

## conf/machine/lx2160ahpcsomubuntu.conf
```bitbake
# The Ubuntu version of the conf file just resets to the normal conf
# file name, so that we do not have to change compatibility settings
# all over the place.
# <Heinz.Wrobel@nxp.com>
MACHINE="lx2160ahpcsom"

require conf/machine/lx2160ahpcsom.conf
require conf/machine/include/ubuntubasics.inc
```

## conf/machine/lx2160ardb2blueboxubuntu.conf
```bitbake
# The Ubuntu version of the conf file just resets to the normal conf
# file name, so that we do not have to change compatibility settings
# all over the place.
# <Heinz.Wrobel@nxp.com>
MACHINE="lx2160ardb2bluebox"

require conf/machine/lx2160ardb2bluebox.conf
require conf/machine/include/ubuntubasics.inc
```

## conf/machine/s32g233aevb3.conf
```bitbake
#@TYPE: Machine
#@NAME: NXP S32G233AEVB3
#@SOC: s32g233a
#@DESCRIPTION: Machine configuration for running the S32G233AEVB3 in 64-bit mode
#@MAINTAINER: Catalin Dan Udma <catalin-dan.udma@nxp.com>
# Copyright 2023 NXP

require conf/machine/include/s32g2evb3.inc
```

## conf/machine/s32g254aevb.conf
```bitbake
#@TYPE: Machine
#@NAME: NXP S32G254AEVB
#@SOC: s32g254a
#@DESCRIPTION: Machine configuration for running the S32G274AEVB in 64-bit mode
#@MAINTAINER: Catalin Dan Udma <catalin-dan.udma@nxp.com>
# Copyright 2020 NXP

require conf/machine/include/s32g2evb.inc
```

## conf/machine/s32g254aevb3ubuntu.conf
```bitbake
# The Ubuntu version of the conf file just resets to the normal conf
# file name, so that we do not have to change compatibility settings
# all over the place.
# <Heinz.Wrobel@nxp.com>
MACHINE="s32g254aevb3"

require conf/machine/s32g254aevb3.conf
require conf/machine/include/s32-ubuntu-board.inc
```

## conf/machine/s32g254aevbubuntu.conf
```bitbake
# The Ubuntu version of the conf file just resets to the normal conf
# file name, so that we do not have to change compatibility settings
# all over the place.
# <Heinz.Wrobel@nxp.com>
MACHINE="s32g254aevb"

require conf/machine/s32g254aevb.conf
require conf/machine/include/s32-ubuntu-board.inc
```

## conf/machine/s32g274a_emu.conf
```bitbake
#@TYPE: Machine
#@NAME: NXP S32G274A ZeBu EMULATOR
#@SOC: s32g274a
#@DESCRIPTION: Machine configuration for running the S32G274A ZeBu EMULATOR in 64-bit mode
#@MAINTAINER: Catalin Dan Udma <catalin-dan.udma@nxp.com>
# Copyright 2017-2019 NXP

require conf/machine/include/s32cc.inc

IMAGE_FSTYPES += "cpio.gz"

VIRTUAL-RUNTIME_dev_manager = "busybox-mdev"
VIRTUAL-RUNTIME_login_manager = "busybox"
VIRTUAL-RUNTIME_init_manager = "busybox"
VIRTUAL-RUNTIME_initscripts = "initscripts"
VIRTUAL-RUNTIME_keymaps = "keymaps"
DISTRO_FEATURES:append += " virtio "
DISTRO_FEATURES:remove = " systemd"

UBOOT_CONFIG = "sdcard"

KERNEL_DEVICETREE ?= "freescale/s32g274a-emu.dtb"
KERNEL_DEFCONFIG ?= "s32cc_emu_defconfig"

UBOOT_DEFCONFIG = "s32g274a_emu_defconfig"
UBOOT_CONFIG[sdcard] = "${UBOOT_DEFCONFIG},,u-boot-nodtb.${UBOOT_SUFFIX}"

ITB_ROOTFS_TYPE = "cpio"

UBOOT_BOOTSPACE_OFFSET = "0"
UBOOT_BOOTSPACE_SEEK = "0"
```

## conf/machine/s32g274abluebox3.conf
```bitbake
#@TYPE: Machine
#@NAME: MicroSys S32G274A SOM for BlueBox3
#@SOC: s32g274a rev 2
#@DESCRIPTION: Machine configuration for running the S32G274A BB3 in 64-bit mode
#@MAINTAINER: Ionut Vicovan <Ionut.Vicovan@nxp.com>
# Copyright (C) 2020 MicroSys Electronics GmbH
# Copyright 2020-2021, 2023 NXP

# We do not map the flashimage offsets in the kernel's device tree.
FLASHIMAGE_DYNAMIC_OFFSETS = "0"

require conf/machine/include/s32g2.inc
require conf/machine/include/qoriq-common.inc

FLASHIMAGE_FIP_OFFSET       = "0x00000000"
FLASHIMAGE_UBOOT_ENV_OFFSET = "0x00280000"
FLASHIMAGE_KERNEL_OFFSET    = "0x00290000"
FLASHIMAGE_DTB_OFFSET       = "0x01160000"
FLASHIMAGE_ROOTFS_OFFSET    = "0x01190000"

ATF_PLAT = "s32g274abluebox3"

UBOOT_DEFCONFIG = "s32g274abluebox3_defconfig"
UBOOT_FLASH_DEFCONFIG = "s32g274abluebox3_qspi_defconfig"

KERNEL_DEVICETREE ??= "freescale/s32g274a-bluebox3.dtb"
require conf/machine/include/s32cc-pfems.inc

FLASHIMAGE_DTB_FILE = "s32g274a-bluebox3.${FLASHIMAGE_DTB_SUFFIX}"

INITRAMFS_IMAGE ?= "fsl-image-nfs-initramfs"
BOOT_SCRIPTS += "${@oe.utils.conditional('INITRAMFS_IMAGE', '', '', '${INITRAMFS_IMAGE}-${MACHINE}.cpio.gz.u-boot:/rootfs.uimg', d)}"
```

## conf/machine/s32g274abluebox3ubuntu.conf
```bitbake
# The Ubuntu version of the conf file just resets to the normal conf
# file name, so that we do not have to change compatibility settings
# all over the place.
# <Heinz.Wrobel@nxp.com>
MACHINE="s32g274abluebox3"

require conf/machine/s32g274abluebox3.conf
require conf/machine/include/s32-ubuntu-board.inc
```

## conf/machine/s32g274aevb.conf
```bitbake
#@TYPE: Machine
#@NAME: NXP S32G274AEVB
#@SOC: s32g274a
#@DESCRIPTION: Machine configuration for running the S32G274AEVB in 64-bit mode
#@MAINTAINER: Catalin Dan Udma <catalin-dan.udma@nxp.com>
# Copyright 2017-2019 NXP

require conf/machine/include/s32g2.inc

UBOOT_DEFCONFIG = "s32g274aevb_defconfig"
UBOOT_FLASH_DEFCONFIG = "s32g274aevb_qspi_defconfig"

KERNEL_DEVICETREE ?= "freescale/fsl-s32g274a-evb.dtb"

FLASHIMAGE_EXTRA1_FILE = "fsl-s32g274a-evb.${FLASHIMAGE_DTB_SUFFIX}"
```

## conf/machine/s32g274aevb3.conf
```bitbake
#@TYPE: Machine
#@NAME: NXP S32G274AEVB3
#@SOC: s32g274a
#@DESCRIPTION: Machine configuration for running the S32G274AEVB3 in 64-bit mode
#@MAINTAINER: Catalin Dan Udma <catalin-dan.udma@nxp.com>
# Copyright 2023 NXP

require conf/machine/include/s32g2evb3.inc
```

## conf/machine/s32g274ardb.conf
```bitbake
#@TYPE: Machine
#@NAME: NXP S32G274ARDB
#@SOC: s32g274a
#@DESCRIPTION: Machine configuration for running the S32G274ARDB in 64-bit mode
#@MAINTAINER: Catalin Dan Udma <catalin-dan.udma@nxp.com>
# Copyright 2019-2020 NXP

require conf/machine/include/s32g2.inc

UBOOT_DEFCONFIG = "s32g274ardb_defconfig"
UBOOT_FLASH_DEFCONFIG = "s32g274ardb_qspi_defconfig"

KERNEL_DEVICETREE ?= "freescale/fsl-s32g274a-rdb.dtb"

FLASHIMAGE_EXTRA1_FILE = "fsl-s32g274a-rdb.${FLASHIMAGE_DTB_SUFFIX}"
```

## conf/machine/s32g274ardb2.conf
```bitbake
#@TYPE: Machine
#@NAME: NXP S32G274ARDB2
#@SOC: s32g274a rev 2
#@DESCRIPTION: Machine configuration for running the S32G274ARDB2 in 64-bit mode
#@MAINTAINER: Catalin Dan Udma <catalin-dan.udma@nxp.com>
# Copyright 2020-2023 NXP

require conf/machine/include/s32g2.inc

ATF_PLAT = "s32g274ardb2"

UBOOT_DEFCONFIG = "s32g274ardb2_defconfig"
UBOOT_FLASH_DEFCONFIG = "s32g274ardb2_qspi_defconfig"

KERNEL_DEVICETREE ??= "freescale/s32g274a-rdb2.dtb"
require conf/machine/include/s32cc-pfems.inc

FLASHIMAGE_DTB_FILE = "s32g274a-rdb2.${FLASHIMAGE_DTB_SUFFIX}"
```

## conf/machine/s32g274sim.conf
```bitbake
#@TYPE: Machine
#@NAME: NXP S32G SIMULATOR
#@SOC: s32g274a
#@DESCRIPTION: Machine configuration for running the S32G SIMULATOR in 64-bit mode
#@MAINTAINER: Catalin Dan Udma <catalin-dan.udma@nxp.com>
# Copyright 2017 NXP

require conf/machine/include/s32-sim-base.inc

SOC_FAMILY:append = ":s32g:s32g2xx"

KERNEL_DEVICETREE ?= "freescale/s32g274a-simulator.dtb"
UBOOT_CONFIG[cpio] = "s32g274a_sim_defconfig,,u-boot-nodtb.${UBOOT_SUFFIX}"
```

## conf/machine/s32g275sim.conf
```bitbake
#@TYPE: Machine
#@NAME: NXP S32G SIMULATOR
#@SOC: s32g275
#@DESCRIPTION: Machine configuration for running the S32G SIMULATOR in 64-bit mode
#@MAINTAINER: Catalin Dan Udma <catalin-dan.udma@nxp.com>
# Copyright 2017 NXP

require conf/machine/include/s32-sim-base.inc

KERNEL_DEVICETREE ?= "freescale/fsl-s32g275-simulator.dtb"
UBOOT_CONFIG[cpio] = "s32g275_config,,u-boot.${UBOOT_SUFFIX}"
```

## conf/machine/s32g378aevb.conf
```bitbake
#@TYPE: Machine
#@NAME: NXP S32G378AEVB
#@SOC: s32g378a
#@DESCRIPTION: Machine configuration for running the S32G378AEVB in 64-bit mode
#@MAINTAINER: Catalin Dan Udma <catalin-dan.udma@nxp.com>
# Copyright 2021-2022 NXP

require conf/machine/include/s32g3evb.inc
```

## conf/machine/s32g379aevb.conf
```bitbake
#@TYPE: Machine
#@NAME: NXP S32G379AEVB
#@SOC: s32g379a
#@DESCRIPTION: Machine configuration for running the S32G379AEVB in 64-bit mode
#@MAINTAINER: Catalin Dan Udma <catalin-dan.udma@nxp.com>
# Copyright 2021-2022 NXP

require conf/machine/include/s32g3evb.inc
```

## conf/machine/s32g379aevb3.conf
```bitbake
#@TYPE: Machine
#@NAME: NXP S32G379AEVB3
#@SOC: s32g379a
#@DESCRIPTION: Machine configuration for running the S32G379AEVB3 in 64-bit mode
#@MAINTAINER: Catalin Dan Udma <catalin-dan.udma@nxp.com>
# Copyright 2022 NXP

require conf/machine/include/s32g3evb3.inc
```

## conf/machine/s32g379aevbubuntu.conf
```bitbake
# The Ubuntu version of the conf file just resets to the normal conf
# file name, so that we do not have to change compatibility settings
# all over the place.
# <Heinz.Wrobel@nxp.com>
MACHINE="s32g379aevb"

require conf/machine/s32g379aevb.conf
require conf/machine/include/s32-ubuntu-board.inc
```
