## conf/machine/s32g398aevb.conf
```bitbake
#@TYPE: Machine
#@NAME: NXP S32G398AEVB
#@SOC: s32g398a
#@DESCRIPTION: Machine configuration for running the S32G398AEVB in 64-bit mode
#@MAINTAINER: Catalin Dan Udma <catalin-dan.udma@nxp.com>
# Copyright 2021-2022 NXP

require conf/machine/include/s32g3evb.inc
```

## conf/machine/s32g399aevb3.conf
```bitbake
#@TYPE: Machine
#@NAME: NXP S32G399AEVB3
#@SOC: s32g399a
#@DESCRIPTION: Machine configuration for running the S32G399AEVB3 in 64-bit mode
#@MAINTAINER: Catalin Dan Udma <catalin-dan.udma@nxp.com>
# Copyright 2022 NXP

require conf/machine/include/s32g3evb3.inc
```

## conf/machine/s32g399ardb3.conf
```bitbake
#@TYPE: Machine
#@NAME: NXP S32G399ARDB3
#@SOC: s32g399a
#@DESCRIPTION: Machine configuration for running the S32G399ARDB3 in 64-bit mode
#@MAINTAINER: Catalin Dan Udma <catalin-dan.udma@nxp.com>
# Copyright 2022-2023 NXP

require conf/machine/include/s32g3.inc

ATF_PLAT = "s32g399ardb3"

UBOOT_DEFCONFIG = "s32g399ardb3_defconfig"
UBOOT_FLASH_DEFCONFIG = "s32g399ardb3_qspi_defconfig"

KERNEL_DEVICETREE ??= "freescale/s32g399a-rdb3.dtb"
require conf/machine/include/s32cc-pfems.inc

FLASHIMAGE_DTB_FILE = "s32g399a-rdb3.${FLASHIMAGE_DTB_SUFFIX}"
```
