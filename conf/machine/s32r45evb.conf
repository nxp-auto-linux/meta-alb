## conf/machine/s32r45evb.conf
```bitbake
#@TYPE: Machine
#@NAME: NXP S32R45XEVB
#@SOC: s32r45
#@DESCRIPTION: Machine configuration for running the S32R45XEVB in 64-bit mode
#@MAINTAINER: Catalin Dan Udma <catalin-dan.udma@nxp.com>
# Copyright 2020, 2023 NXP

require conf/machine/include/s32r45.inc

ATF_PLAT = "s32r45evb"

UBOOT_DEFCONFIG = "s32r45evb_defconfig"
UBOOT_FLASH_DEFCONFIG = "s32r45evb_qspi_defconfig"

KERNEL_DEVICETREE ?= "freescale/s32r45-evb.dtb"

FLASHIMAGE_DTB_FILE = "s32r45-evb.${FLASHIMAGE_DTB_SUFFIX}"
```

## conf/machine/s32r45renan.conf
```bitbake
#@TYPE: Machine
#@NAME: NXP S32R45RENAN
#@SOC: s32r45
#@DESCRIPTION: Machine configuration for running the S32R45RENAN in 64-bit mode
#@MAINTAINER: Catalin Dan Udma <catalin-dan.udma@nxp.com>
# Copyright 2023 NXP

require conf/machine/include/s32r45.inc

ATF_PLAT = "s32r45renan"
BOOT_TYPE = "sdcard"

UBOOT_DEFCONFIG = "s32r45renan_defconfig"

KERNEL_DEVICETREE ?= "freescale/s32r45-renan.dtb"
UBOOT_CONFIG:remove = "qspi "
```

## conf/machine/s32r45sim.conf
```bitbake
#@TYPE: Machine
#@NAME: NXP S32R SIMULATOR
#@SOC: s32r45
#@DESCRIPTION: Machine configuration for running the S32R45X SIMULATOR in 64-bit mode
#@MAINTAINER: Catalin Dan Udma <catalin-dan.udma@nxp.com>
# Copyright 2017 NXP

require conf/machine/include/s32-sim-base.inc

KERNEL_DEVICETREE ?= "freescale/s32r45-simulator.dtb"
UBOOT_CONFIG[cpio] = "s32r45_sim_defconfig,,u-boot-nodtb.${UBOOT_SUFFIX}"
```

## conf/machine/s32r45xevb.conf
```bitbake
#@TYPE: Machine
#@NAME: NXP S32R45XEVB
#@SOC: s32r45x
#@DESCRIPTION: Machine configuration for running the S32R45XEVB in 64-bit mode
#@MAINTAINER: Catalin Dan Udma <catalin-dan.udma@nxp.com>
# Copyright 2020 NXP

require conf/machine/include/s32-gen1-board.inc

UBOOT_DEFCONFIG = "s32r45xevb_defconfig"
UBOOT_FLASH_DEFCONFIG = "s32r45xevb_qspi_defconfig"

KERNEL_DEVICETREE ?= "freescale/fsl-s32r45x-evb.dtb"
KERNEL_DEFCONFIG ?= "s32r45x_defconfig"

UBOOT_CONFIG ?= "sdcard"
UBOOT_CONFIG[sdcard] = "${UBOOT_DEFCONFIG},,u-boot.${UBOOT_SUFFIX}"

# prepend 'qspi' to keep the default deploy/u-boot-<MACHINE>.s32 to point to sdcard
UBOOT_CONFIG_prepend = "qspi "
UBOOT_CONFIG[qspi] = "${UBOOT_FLASH_DEFCONFIG},,u-boot.${UBOOT_SUFFIX}"

FLASHIMAGE_EXTRA1_FILE = "fsl-s32r45x-evb.${FLASHIMAGE_DTB_SUFFIX}"
```

## conf/machine/s32r45xevbubuntu.conf
```bitbake
# The Ubuntu version of the conf file just resets to the normal conf
# file name, so that we do not have to change compatibility settings
# all over the place.
# <Heinz.Wrobel@nxp.com>
MACHINE="s32r45xevb"

require conf/machine/s32r45xevb.conf
require conf/machine/include/s32-ubuntu-board.inc
```

## conf/machine/s32r45xsim.conf
```bitbake
#@TYPE: Machine
#@NAME: NXP S32R SIMULATOR
#@SOC: s32r45x
#@DESCRIPTION: Machine configuration for running the S32R45X SIMULATOR in 64-bit mode
#@MAINTAINER: Linux BSP Team
# Copyright 2017 NXP

require conf/machine/include/s32-sim-base.inc

KERNEL_DEVICETREE ?= "freescale/s32r45x-simulator.dtb"
UBOOT_CONFIG[cpio] = "s32r45x_config,,u-boot.${UBOOT_SUFFIX}"
```

## conf/machine/s32v234bbmini.conf
```bitbake
#@TYPE: Machine
#@NAME: NXP BlueBox Mini
#@SOC: s32v2xx
#@DESCRIPTION: Machine configuration for running the S32V234 in BlueBox Mini in 64-bit mode
#@MAINTAINER: Heinz Wrobel <Heinz.Wrobel@nxp.com>
# Copyright 2019-2020 NXP

require conf/machine/include/s32v2xx.inc

KERNEL_DEVICETREE ?= "freescale/fsl-s32v234-bbmini.dtb"
KERNEL_DEFCONFIG ?= "s32v234_defconfig"

EXTRA_IMAGECMD_ext4 = "-i 4096 -L ${IMAGE_NAME}"
IMAGE_FSTYPES_remove = "jffs2 ubi ext2.gz ext2.gz.u-boot"

INITRAMFS_IMAGE ?= "fsl-image-nfs-initramfs"
BOOT_SCRIPTS += "${@oe.utils.conditional('INITRAMFS_IMAGE', '', '', '${INITRAMFS_IMAGE}-${MACHINE}.cpio.gz.u-boot:/rootfs.uimg', d)}"

#Define dependencies for .flashimage
#Offset values are in bytes and are deduced from the values defined in
#u-boot/include/configs/s32.h as {KERNEL|FDT|RAMDISK}_FLASH_ADDR
FLASHIMAGE_UBOOT_TYPE = "qspi"
#Normally only FLASHIMAGE_UBOOT_TYPE should be enough, but we also define
#the *_SUFFIX and *_FILE for safety
require include/s32v2flashmap.inc
FLASHIMAGE_SIZE="64"
FLASHIMAGE_UBOOT_SUFFIX = "${UBOOT_SUFFIX}"
#FLASHIMAGE_UBOOT_FILE = "u-boot-${MACHINE}.${FLASHIMAGE_UBOOT_SUFFIX}-${FLASHIMAGE_UBOOT_TYPE}"
FLASHIMAGE_KERNEL_FILE = "${KERNEL_IMAGETYPE}"
FLASHIMAGE_DTB_SUFFIX = "dtb"
FLASHIMAGE_EXTRA1 = "virtual/kernel"
FLASHIMAGE_EXTRA1_FILE = "fsl-s32v234-bbmini.${FLASHIMAGE_DTB_SUFFIX}"
FLASHIMAGE_EXTRA1_OFFSET = "${FLASHIMAGE_DTB_OFFSET}"
FLASHIMAGE_ROOTFS = "fsl-image-auto"
FLASHIMAGE_ROOTFS_SUFFIX = "cpio.gz.u-boot"
FLASHIMAGE_ROOTFS_FILE = "${FLASHIMAGE_ROOTFS}-${MACHINE}.${FLASHIMAGE_ROOTFS_SUFFIX}"

IMAGE_ROOTFS_DEP_EXT ?= "ext4"
```

## conf/machine/s32v234bbminiubuntu.conf
```bitbake
# The Ubuntu version of the conf file just resets to the normal conf
# file name, so that we do not have to change compatibility settings
# all over the place.
# <Heinz.Wrobel@nxp.com>
MACHINE="s32v234bbmini"

require conf/machine/s32v234bbmini.conf
require conf/machine/include/s32-ubuntu-board.inc
```

## conf/machine/s32v234campp.conf
```bitbake
#@TYPE: Machine
#@NAME: NXP S32V234 Camera Pre-Processing Board.
#@SOC: s32v2xx
#@DESCRIPTION: Machine configuration for running the S32V234CAMPP in 64-bit mode
#@MAINTAINER: Catalin Udma <catalin-dan.udma@nxp.com>
# Copyright 2020 NXP

require conf/machine/include/s32v2xx.inc

KERNEL_DEVICETREE = "freescale/fsl-s32v234-campp-primary.dtb freescale/fsl-s32v234-campp-secondary.dtb"
KERNEL_DEFCONFIG ?= "s32v234_campp_defconfig"

UBOOT_CONFIG[sdcard] ?= "${MACHINE}_config,,u-boot.${UBOOT_SUFFIX}"

INITRAMFS_IMAGE ?= "fsl-image-nfs-initramfs"
BOOT_SCRIPTS += "${@oe.utils.conditional('INITRAMFS_IMAGE', '', '', '${INITRAMFS_IMAGE}-${MACHINE}.cpio.gz.u-boot:/rootfs.uimg', d)}"

FLASHIMAGE_SIZE="64"
FLASHIMAGE_UBOOT_SUFFIX = "${UBOOT_SUFFIX}"
FLASHIMAGE_KERNEL_FILE = "${KERNEL_IMAGETYPE}"
FLASHIMAGE_DTB_SUFFIX = "dtb"
```

## conf/machine/s32v234ccpb.conf
```bitbake
#@TYPE: Machine
#@NAME: S32V234CCPB
#@SOC: s32v2xx
#@DESCRIPTION: Machine configuration for the X-S32GRV-PLAT board, Schematics 30081, using the X-S32V234TPROC board, Schematics 30094, as processor board. 
#@MAINTAINER: Catalin Dan Udma <catalin-dan.udma@nxp.com>
# Copyright 2018 NXP

require conf/machine/include/s32v2xx.inc

KERNEL_DEVICETREE ?= "freescale/fsl-s32v234-ccpb.dtb"
KERNEL_DEFCONFIG ?= "s32v234_defconfig"

UBOOT_BOOTSPACE_SEEK ?= "8"
UBOOT_SUFFIX ?= "s32"
UBOOT_KERNEL_IMAGETYPE ?= "Image"
UBOOT_ENTRYPOINT ?= "80080000"
UBOOT_CONFIG[sdcard] = "s32v234ccpb_config,,u-boot.${UBOOT_SUFFIX}"

SERIAL_CONSOLES = "115200;ttyLF0"

# we do not want to have getty running on tty1 as we run
# auto-serial-console there USE_VT = "0"

EXTRA_IMAGEDEPENDS += "u-boot-s32"
```

## conf/machine/s32v234evb.conf
```bitbake
#@TYPE: Machine
#@NAME: NXP S32V234EVB
#@SOC: s32v2xx
#@DESCRIPTION: Machine configuration for running the S32V234EVB in 64-bit mode
#@MAINTAINER: Catalin Udma <catalin-dan.udma@nxp.com>
# Copyright 2017-2019 NXP

require conf/machine/include/s32v2xx.inc

KERNEL_DEVICETREE ?= "freescale/fsl-s32v234-evb.dtb"
KERNEL_DEFCONFIG ?= "s32v234_defconfig"

# prepend qspi to keep the default deploy/u-boot-<MACHINE>.s32 to point to sdcard
UBOOT_CONFIG_prepend = "qspi "
UBOOT_CONFIG[qspi] = "${MACHINE}_flash_config,,u-boot.${UBOOT_SUFFIX}"

INITRAMFS_IMAGE ?= "fsl-image-nfs-initramfs"
BOOT_SCRIPTS += "${@oe.utils.conditional('INITRAMFS_IMAGE', '', '', '${INITRAMFS_IMAGE}-${MACHINE}.cpio.gz.u-boot:/rootfs.uimg', d)}"

#Define dependencies for .flashimage
#Offset values are in bytes and are deduced from the values defined in
#u-boot/include/configs/s32.h as {KERNEL|FDT|RAMDISK}_FLASH_ADDR
FLASHIMAGE_UBOOT_TYPE = "qspi"
#Normally only FLASHIMAGE_UBOOT_TYPE should be enough, but we also define
#the *_SUFFIX and *_FILE for safety
require include/s32v2flashmap.inc
FLASHIMAGE_SIZE="64"
FLASHIMAGE_UBOOT_SUFFIX = "${UBOOT_SUFFIX}"
#FLASHIMAGE_UBOOT_FILE = "u-boot-${MACHINE}.${FLASHIMAGE_UBOOT_SUFFIX}-${FLASHIMAGE_UBOOT_TYPE}"
FLASHIMAGE_KERNEL_FILE = "${KERNEL_IMAGETYPE}"
FLASHIMAGE_DTB_SUFFIX = "dtb"
FLASHIMAGE_EXTRA1 = "virtual/kernel"
FLASHIMAGE_EXTRA1_FILE = "fsl-s32v234-evb.${FLASHIMAGE_DTB_SUFFIX}"
FLASHIMAGE_EXTRA1_OFFSET = "${FLASHIMAGE_DTB_OFFSET}"
FLASHIMAGE_ROOTFS = "fsl-image-base"
FLASHIMAGE_ROOTFS_SUFFIX = "cpio.gz.u-boot"
FLASHIMAGE_ROOTFS_FILE = "${FLASHIMAGE_ROOTFS}-${MACHINE}.${FLASHIMAGE_ROOTFS_SUFFIX}"

IMAGE_FSTYPES += "${FLASHIMAGE_ROOTFS_SUFFIX}"
```

## conf/machine/s32v234evb28899.conf
```bitbake
#@TYPE: Machine
#@NAME: NXP S32V234EVB SCH 28899
#@SOC: s32v2xx
#@DESCRIPTION: Machine configuration for running the S32V234EVB SCH 28899 in 64-bit mode
#@MAINTAINER: Catalin Dan Udma <catalin-dan.udma@nxp.com>
# Copyright 2017-2018 NXP

require conf/machine/include/s32v2xx.inc

KERNEL_DEVICETREE ?= "freescale/fsl-s32v234-evb28899.dtb"
KERNEL_DEFCONFIG ?= "s32v234_defconfig"
```

## conf/machine/s32v234evbubuntu.conf
```bitbake
# The Ubuntu version of the conf file just resets to the normal conf
# file name, so that we do not have to change compatibility settings
# all over the place.
# <Heinz.Wrobel@nxp.com>
MACHINE="s32v234evb"
require conf/machine/include/s32-ubuntu-board.inc
require conf/machine/s32v234evb.conf

# Temporary removal of flash image filesystem support
# for Ubuntu images due to an issue regarding 'cpio'
# utilitary on Ubuntu 18.04 host when seeking on
# large files (> 2 GB)
IMAGE_FSTYPES_remove = "${FLASHIMAGE_ROOTFS_SUFFIX}"
```

## conf/machine/s32v234hpcsom.conf
```bitbake
#@TYPE: Machine
#@NAME: NXP S32V234 HPC SOM Board.
#@SOC: s32v2xx
#@DESCRIPTION: Machine configuration for running the S32V234HPCSOM in 64-bit mode
#@MAINTAINER: Andrei Botila <andrei.botila@nxp.com>
# Copyright 2021 NXP

require conf/machine/include/s32v2xx.inc

KERNEL_DEVICETREE = "freescale/fsl-s32v234-hpcsom.dtb"
KERNEL_DEFCONFIG ?= "s32v234_defconfig"

PREFERRED_VERSION_linux-s32 = "5.4"

UBOOT_CONFIG[sdcard] ?= "${MACHINE}_config,,u-boot.${UBOOT_SUFFIX}"
```

## conf/machine/s32v234pcie.conf
```bitbake
#@TYPE: Machine
#@NAME: NXP S32V234PCIE
#@SOC: s32v2xx
#@DESCRIPTION: Machine configuration for running the S32V234PCIE in 64-bit mode
#@MAINTAINER: Catalin Udma <catalin-dan.udma@nxp.com>
# Copyright 2017-2018 NXP

require conf/machine/include/s32v2xx.inc

KERNEL_DEVICETREE ?= "freescale/fsl-s32v234-pcie.dtb"
KERNEL_DEFCONFIG ?= "s32v234_defconfig"

SERIAL_CONSOLES = "115200;ttyLF1"
```

## conf/machine/s32v234sbc.conf
```bitbake
#@TYPE: Machine
#@NAME: SBC-S32V234
#@SOC: s32v2xx
#@DESCRIPTION: Machine configuration for running the SBC-S32V234 SCH 29288 in 64-bit mode
#@MAINTAINER: Catalin Dan Udma <catalin-dan.udma@nxp.com>
# Copyright 2018 NXP

require conf/machine/include/s32v2xx.inc

KERNEL_DEVICETREE ?= "freescale/fsl-s32v234sbc.dtb"
KERNEL_DEFCONFIG ?= "s32v234_defconfig"

UBOOT_BOOTSPACE_SEEK ?= "8"
UBOOT_SUFFIX ?= "s32"
UBOOT_KERNEL_IMAGETYPE ?= "Image"
UBOOT_ENTRYPOINT ?= "80080000"
UBOOT_CONFIG[sdcard] = "s32v234sbc_config,,u-boot.${UBOOT_SUFFIX}"

SERIAL_CONSOLES = "115200;ttyLF0"

# we do not want to have getty running on tty1 as we run
# auto-serial-console there USE_VT = "0"

EXTRA_IMAGEDEPENDS += "u-boot-s32"
```

## conf/machine/s32v234tmdp.conf
```bitbake
#@TYPE: Machine
#@NAME: NXP S32V234TMDP
#@SOC: s32v2xx
#@DESCRIPTION: Machine configuration for running the S32V234TMDP in 64-bit mode

require conf/machine/include/s32v2xx.inc

KERNEL_DEVICETREE ?= "freescale/fsl-s32v234-tmdp.dtb"
KERNEL_DEFCONFIG ?= "s32v234_defconfig"
```

## conf/machine/s32v244sim.conf
```bitbake
#@TYPE: Machine
#@NAME: NXP S32V244 SIMULATOR
#@SOC: s32v244
#@DESCRIPTION: Machine configuration for running the S32V244 SIMULATOR in 64-bit mode
#@MAINTAINER: Linux BSP Team
# Copyright 2017 NXP

require conf/machine/include/s32v2xx-base.inc

KERNEL_DEVICETREE ?= "freescale/s32v244-simulator.dtb"
KERNEL_DEFCONFIG ?= "${S}/arch/arm64/configs/s32gen1_defconfig"
UBOOT_MACHINE = "s32v244_config"

UBOOT_BOOTSPACE_SEEK ?= "8"
UBOOT_SUFFIX ?= "bin"
UBOOT_KERNEL_IMAGETYPE ?= "Image"
UBOOT_ENTRYPOINT ?= "80080000"


SERIAL_CONSOLE = "115200 ttyLF0"

# we do not want to have getty running on tty1 as we run
# auto-serial-console there USE_VT = "0"

EXTRA_IMAGEDEPENDS += "u-boot-s32v2xx"

SDCARD_ROOTFS ?= "${DEPLOY_DIR_IMAGE}/${IMAGE_NAME}.rootfs.ext3"
```

## conf/machine/s32v344sim.conf
```bitbake
#@TYPE: Machine
#@NAME: NXP S32V244 SIMULATOR
#@SOC: s32v344
#@DESCRIPTION: Machine configuration for running the S32V244 SIMULATOR in 64-bit mode
#@MAINTAINER: Catalin Dan Udma <catalin-dan.udma@nxp.com>
# Copyright 2017 NXP

require conf/machine/include/s32-sim-base.inc

KERNEL_DEVICETREE ?= "freescale/s32v344-simulator.dtb"
UBOOT_CONFIG[cpio] = "s32v344_config,,u-boot.${UBOOT_SUFFIX}"
```

## conf/machine/t4bluebox.conf
```bitbake
require conf/machine/t4240rdb-64b.conf

IMAGE_CLASSES += "image_types_fsl_flashimage"

IMAGE_FSTYPES += "ext2 ext3"
EXTRA_IMAGECMD_ext3 = "-i 4096 -L ${IMAGE_NAME}"

# On the Blue Box we have a 128MB NOR flash for T4 and Bank 4 support
FLASHIMAGE_SIZE = "128"
FLASHIMAGE_BANK4 = "yes"
FLASHIMAGE_RESET = "rcw"
FLASHIMAGE_RESET_FILE = "rcw/${MACHINE}/SSFFPPH_27_55_1_9/rcw_27_55_1_9_1800MHz.bin"
FLASHIMAGE_RESET_OFFSET = "0x00000000"
FLASHIMAGE_KERNEL_FILE = "uImage-${MACHINE}.bin"
FLASHIMAGE_KERNEL_OFFSET = "0x00020000"
FLASHIMAGE_DTB = "virtual/kernel"
FLASHIMAGE_DTB_FILE = "uImage-t4240rdb.dtb"
FLASHIMAGE_DTB_OFFSET = "0x00800000"
FLASHIMAGE_UBOOT_OFFSET = "0x07f40000"
FLASHIMAGE_ROOTFS = "fsl-image-itbflash"
FLASHIMAGE_ROOTFS_FILE = "${FLASHIMAGE_ROOTFS}-${MACHINE}.${FLASHIMAGE_ROOTFS_SUFFIX}"
FLASHIMAGE_ROOTFS_SUFFIX = "ext2.gz.u-boot"
FLASHIMAGE_ROOTFS_OFFSET = "0x01300000"
FLASHIMAGE_EXTRA1 = "hv-cfg"
FLASHIMAGE_EXTRA1_FILE = "hv-cfg/SSFFPPH_28_56_2_10/hv-2p-lnx-lnx.dtb"
FLASHIMAGE_EXTRA1_OFFSET = "0x00900000"
FLASHIMAGE_EXTRA2 = "hypervisor"
FLASHIMAGE_EXTRA2_FILE = "hv/hv.uImage"
FLASHIMAGE_EXTRA2_OFFSET = "0x00700000"
FLASHIMAGE_EXTRA3 = "u-boot-environment"
FLASHIMAGE_EXTRA3_FILE = "u-boot-flashenv-${MACHINE}.bin"
FLASHIMAGE_EXTRA3_OFFSET = "0x07f20000"
FLASHIMAGE_EXTRA4 = "fm-ucode"
FLASHIMAGE_EXTRA4_FILE = "fsl_fman_ucode_t4240_r2.0_106_4_18.bin"
FLASHIMAGE_EXTRA4_OFFSET = "0x07f00000"
FLASHIMAGE_EXTRA5 = "ls2-phy"
FLASHIMAGE_EXTRA5_FILE = "ls2-phy/cs4315-cs4340-PHY-ucode.txt"
FLASHIMAGE_EXTRA5_OFFSET = "0x07e00000"
## Special magic to permit hypervisor scenarios without additional flash change
#FLASHIMAGE_EXTRA6 = "virtual/kernel"
#FLASHIMAGE_EXTRA6_FILE = "uImage-t4240rdb-usdpaa.dtb"
#FLASHIMAGE_EXTRA6_OFFSET = "0x00880000"
```

## dynamic-layers/meta-qoriq/conf/layer.conf
```bitbake
# We have a conf and classes directory, add to BBPATH
BBPATH .= ":${LAYERDIR}"

# We have a packages directory, add to BBFILES
BBFILES += "${LAYERDIR}/recipes-*/*/*.bb \
            ${LAYERDIR}/recipes-*/*/*.bbappend"

BBFILE_COLLECTIONS += "meta-qoriq"
BBFILE_PATTERN_meta-qoriq := "^${LAYERDIR}/"
BBFILE_PRIORITY_meta-qoriq = "8"
LAYERSERIES_COMPAT_meta-qoriq = "zeus dunfell"
HOSTTOOLS_NONFATAL_append = " whoami"
BBMASK_qoriq += "/meta-imx/meta-bsp/recipes-core"
BBMASK_qoriq += "/meta-imx/meta-bsp/recipes-devtools"
IMAGE_CLASSES_remove = "image_types_create_sdcard_symlink"
```
