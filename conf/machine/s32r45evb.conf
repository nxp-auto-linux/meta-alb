## images/fsl-image-s32v2xx-sec/s32v234-image-sec.its
```
/*
 * Copyright (C) 2016, Freescale Semiconductor
 *
 * Ghennadi Procopciuc <ghennadi.procopciuc@nxp.com>
 *
 * This file is licensed under the terms of the GNU General Public
 * License version 2.  This program is licensed "as is" without any
 * warranty of any kind, whether express or implied.
 */

/dts-v1/;

/ {
	description = "Image file for the S32V234 Linux Kernel";
	#address-cells = <1>;

	images {
		kernel@1 {
			description = "ARM64 Linux kernel";
			data = /incbin/("./Image");
			type = "kernel";
			arch = "arm64";
			os = "linux";
			compression = "none";
			load = <0x80080000>;
			entry = <0x80080000>;

			/**
			 * The signature is generated using uboot by calling 'genmac' command
			 * Please see 'Sign and authenticate the other images used at runtime'
			 * section from User Manual for more details.
			 */
			signature@1 {
				algo = "cmac";
				value = "\xa2\x35\x89\x6b\xe0\xeb\x8f\x07\xb5\x36\xc3\x82\x01\xb4\x91\xcf";
			};
		};

		fdt@1 {
			description = "Flattened Device Tree blob";
			data = /incbin/("s32v234.dtb");
			type = "flat_dt";
			arch = "arm64";
			compression = "none";
			load = <0x82000000>;

			signature@1 {
				algo = "cmac";
				value = "\xc1\x33\x5f\x9b\xa0\xa8\xb6\x3a\x23\x37\x1c\x26\xeb\xb5\xab\x3b";
			};

		};
	};

	configurations {
		default = "config@1";
		config@1 {
			description = "Boot Linux kernel";
			kernel = "kernel@1";
			fdt = "fdt@1";
		};
	};
};
```

## recipes-bsp/bbdeployscripts/bbdeployscripts/bbdeployimage.its
```
/*
 * Copyright (C) 2016-2017,2021 NXP
 * <Heinz.Wrobel@nxp.com>
 */

/dts-v1/;

/ {
    description = "BlueBox Image file for flash deployment";

    images {
        ls1nordeployflash@1 {
            description = "LS1 NOR flash deployment script";
            data = /incbin/("ls1nordeployimage.txt");
            type = "script";
            compression = "none";
        };
        ls2deployflash@1 {
            description = "LS2 NOR flash deployment script";
            data = /incbin/("ls2deployimage.txt");
            type = "script";
            compression = "none";
        };
        ls2factoryprep@1 {
            description = "LS2 BB Mini factory deployment script";
            data = /incbin/("ls2factoryprep.txt");
            type = "script";
            compression = "none";
        };
        s32gqspideploy@1 {
            description = "S32G Bluebox3 QSPI factory deployment script";
            data = /incbin/("s32gqspideploy.txt");
            type = "script";
            compression = "none";
        };
        s32gemmcdeploy@1 {
            description = "S32G Bluebox3 eMMC factory deployment script";
            data = /incbin/("s32gemmcdeploy.txt");
            type = "script";
            compression = "none";
        };
        s32grcwdeploy@1 {
            description = "S32G Bluebox3 RCW factory deployment script";
            data = /incbin/("s32grcwdeploy.txt");
            type = "script";
            compression = "none";
        };
        s32gdeployall@1 {
            description = "S32G Bluebox3 run all factory deployment scripts";
            data = /incbin/("s32gdeployall.txt");
            type = "script";
            compression = "none";
        };
    };

};
```

## recipes-kernel/linux/files/defconfig
```kconfig
#
# CD-ROM/DVD Filesystems
# We want this to allow native mounts of SDK ISOs
#
CONFIG_ISO9660_FS=m
CONFIG_UDF_FS=m
# CONFIG_JOLIET is not set
# CONFIG_ZISOFS is not set
CONFIG_UDF_NLS=y
CONFIG_CRC_ITU_T=m

#
# USB port drivers
# We want this to allow monitoring the S32V UART via the LS2 USB for simplicity
#
CONFIG_USB_SERIAL=m
CONFIG_USB_SERIAL_GENERIC=m
CONFIG_USB_SERIAL_FTDI_SIO=m


#
# USB Physical Layer drivers
# We want this to support USB3 test cards on PCIe, e.g., in a T4240RDB
#
CONFIG_USB_PHY=y
# CONFIG_USB_ISP1301 is not set
CONFIG_USB_RCAR_PHY=m
# CONFIG_USB_GADGET is not set




CONFIG_AUDITSYSCALL=y
CONFIG_AUDIT_WATCH=y
CONFIG_AUDIT_TREE=y

# To support Ubuntu libpam-systemvd installation
CONFIG_CGROUPS=y
# CONFIG_CGROUP_DEBUG is not set
# CONFIG_CGROUP_FREEZER is not set
# CONFIG_CGROUP_DEVICE is not set
# CONFIG_CPUSETS is not set
# CONFIG_CGROUP_CPUACCT is not set
# CONFIG_RESOURCE_COUNTERS is not set
# CONFIG_CGROUP_PERF is not set
# CONFIG_CGROUP_SCHED is not set
# CONFIG_BLK_CGROUP is not set

# CONFIG_NETLABEL is not set
CONFIG_NETWORK_SECMARK=y


# To support video

CONFIG_VGASTATE=y
CONFIG_FB=y
# CONFIG_FIRMWARE_EDID is not set
# CONFIG_FB_DDC is not set
CONFIG_FB_BOOT_VESA_SUPPORT=y
CONFIG_FB_CFB_FILLRECT=y
CONFIG_FB_CFB_COPYAREA=y
CONFIG_FB_CFB_IMAGEBLIT=y
# CONFIG_FB_CFB_REV_PIXELS_IN_BYTE is not set
CONFIG_FB_SYS_FILLRECT=y
CONFIG_FB_SYS_COPYAREA=y
CONFIG_FB_SYS_IMAGEBLIT=y
CONFIG_FB_FOREIGN_ENDIAN=y
CONFIG_FB_BOTH_ENDIAN=y
CONFIG_FB_SYS_FOPS=y
CONFIG_FB_DEFERRED_IO=y
# CONFIG_FB_SVGALIB is not set
# CONFIG_FB_MACMODES is not set
# CONFIG_FB_BACKLIGHT is not set
# CONFIG_FB_MODE_HELPERS is not set
# CONFIG_FB_TILEBLITTING is not set

#
# Frame buffer hardware drivers
#
# CONFIG_FB_CIRRUS is not set
# CONFIG_FB_PM2 is not set
# CONFIG_FB_CYBER2000 is not set
# CONFIG_FB_OF is not set
# CONFIG_FB_ASILIANT is not set
# CONFIG_FB_IMSTT is not set
# CONFIG_FB_VGA16 is not set
# CONFIG_FB_S1D13XXX is not set
# CONFIG_FB_NVIDIA is not set
# CONFIG_FB_RIVA is not set
# CONFIG_FB_I740 is not set
# CONFIG_FB_MATROX is not set
CONFIG_FB_RADEON=y
CONFIG_FB_RADEON_I2C=y
CONFIG_FB_RADEON_BACKLIGHT=y
# CONFIG_FB_ATY128 is not set
# CONFIG_FB_ATY is not set
# CONFIG_FB_S3 is not set
# CONFIG_FB_SAVAGE is not set
# CONFIG_FB_SIS is not set
# CONFIG_FB_NEOMAGIC is not set
# CONFIG_FB_KYRO is not set
# CONFIG_FB_3DFX is not set
# CONFIG_FB_VOODOO1 is not set
# CONFIG_FB_VT8623 is not set
# CONFIG_FB_TRIDENT is not set
# CONFIG_FB_ARK is not set
# CONFIG_FB_PM3 is not set
# CONFIG_FB_CARMINE is not set
# CONFIG_FB_FSL_SII902X is not set
# CONFIG_FB_FSL_DCU is not set
# CONFIG_FB_FSL_DIU is not set
# CONFIG_FB_SSD1289 is not set
# CONFIG_FB_SMSCUFX is not set
CONFIG_FB_UDL=y
# CONFIG_FB_IBM_GXT4500 is not set
# CONFIG_FB_GOLDFISH is not set
# CONFIG_FB_VIRTUAL is not set
# CONFIG_FB_METRONOME is not set
# CONFIG_FB_MB862XX is not set
# CONFIG_FB_BROADSHEET is not set
# CONFIG_FB_AUO_K190X is not set
# CONFIG_FB_SIMPLE is not set
# CONFIG_FB_SSD1307 is not set
# CONFIG_FB_SM7XX is not set
# CONFIG_FB_XGI is not set


# To support SELinux for Ubuntu

CONFIG_NETWORK_SECMARK=y
CONFIG_SECURITY=y
CONFIG_SECURITY_NETWORK=y
# CONFIG_SECURITY_NETWORK_XFRM is not set
# CONFIG_SECURITY_PATH is not set
CONFIG_LSM_MMAP_MIN_ADDR=65536
CONFIG_SECURITY_SELINUX=y
# CONFIG_SECURITY_SELINUX_BOOTPARAM is not set
# CONFIG_SECURITY_SELINUX_DISABLE is not set
CONFIG_SECURITY_SELINUX_DEVELOP=y
CONFIG_SECURITY_SELINUX_AVC_STATS=y
CONFIG_SECURITY_SELINUX_CHECKREQPROT_VALUE=1
# CONFIG_SECURITY_SELINUX_POLICYDB_VERSION_MAX is not set
# CONFIG_SECURITY_SMACK is not set
# CONFIG_SECURITY_TOMOYO is not set
# CONFIG_SECURITY_APPARMOR is not set
# CONFIG_SECURITY_YAMA is not set
# CONFIG_IMA is not set
# CONFIG_EVM is not set
# CONFIG_DEFAULT_SECURITY_SELINUX is not set
```
