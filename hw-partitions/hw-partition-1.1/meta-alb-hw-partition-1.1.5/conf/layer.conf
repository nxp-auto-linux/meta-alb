## meta-alb-bsp/conf/machine/include/atf.inc
```bitbake
# Copyright 2020-2021, 2024 NXP

TFA_IMAGE = "arm-trusted-firmware"
TFA_IMAGE_FILE ?= "fip.bin-sdcard"
TFA_RESET = "arm-trusted-firmware"
TFA_RESET_FILE ?= "bl2_w_dtb.s32-sdcard"
UBOOT_NAME_SDCARD = "${TFA_RESET_FILE}"
FIRMWARE_NAME_SDCARD = "${TFA_IMAGE_FILE}"

FLASHIMAGE_FIP = "arm-trusted-firmware"
FLASHIMAGE_FIP_FILE = "fip.bin-qspi"
FLASHIMAGE_RESET = "arm-trusted-firmware"
FLASHIMAGE_RESET_FILE ?= "bl2_w_dtb.s32-qspi"
```

## meta-alb-bsp/conf/machine/include/hse-verifiedboot.inc
```bitbake
# Copyright 2023-2025 NXP

SDCARDIMAGE_BOOT_EXTRA_FILES:append = " linux-s32:Image-kernel-signed.itb"
```

## meta-alb-bsp/conf/machine/include/m7-boot.inc
```bitbake
# Copyright 2021, 2024 NXP

TFA_IMAGE = "arm-trusted-firmware"
TFA_IMAGE_FILE = "fip.bin-sdcard"
TFA_RESET = "m7-sample"
TFA_RESET_FILE = "bl2_w_dtb.s32-sdcard.m7"
UBOOT_NAME_SDCARD = "${TFA_RESET_FILE}"
FIRMWARE_NAME_SDCARD = "${TFA_IMAGE_FILE}"

FLASHIMAGE_FIP = "arm-trusted-firmware"
FLASHIMAGE_FIP_FILE = "fip.bin-qspi"
FLASHIMAGE_RESET = "m7-sample"
FLASHIMAGE_RESET_FILE = "bl2_w_dtb.s32-qspi.m7"
```

## meta-alb-bsp/conf/machine/include/s32-sim-base.inc
```bitbake
IMAGE_FSTYPES += "cpio.gz"

DISTRO_FEATURES:append = " virtio"

INIT_MANAGER = "${@bb.utils.contains('DISTRO_FEATURES', 'xen', 'systemd', 'mdev-busybox', d)}"
```

## meta-alb-bsp/conf/machine/include/s32cc-dm-verity.inc
```bitbake
DM_VERITY_IMAGE ?= "fsl-image-base"
DM_VERITY_IMAGE_TYPE = "ext3"
IMAGE_CLASSES += "dm-verity-img"

INITRAMFS_IMAGE = "dm-verity-image-initramfs"
INITRAMFS_FSTYPES = "cpio.gz cpio.gz.u-boot"
INITRAMFS_IMAGE_BUNDLE = "1"

IMAGE_BOOT_FILES:remove = "Image"
IMAGE_BOOT_FILES:append = " ${@bb.utils.contains('DISTRO_FEATURES', 'verifiedboot', ' Image-kernel-signed.itb', ' Image-initramfs-${MACHINE}.bin;Image', d)}"
IMAGE_BOOT_FILES:append = " ${@os.path.basename(d.getVar("KERNEL_DEVICETREE"))}"

WKS_FILE = "s32cc-sdimage-verity.wks.in"
```

## meta-alb-bsp/conf/machine/include/s32cc-image.inc
```bitbake
SD_FAT_BOOT_DIR = ""
SD_FAT_DTB_DIR = ""

SD_INCLUDE_BL2_PART = "0"

SD_FIP_BURN_PART_INDEX = "1"
SD_FW_SIZE_ALIGNED = "${SD_FIP_SIZE_ALIGNED}"
SD_FIP_PATH = "${DEPLOY_DIR_IMAGE}/${FIRMWARE_NAME_SDCARD}"

SDCARD_PARTITIONING_SCHEME = "msdos"

SDCARD_BL2_PARTITION_NAME = ""
SDCARD_FIP_PARTITION_NAME = "primary"
SDCARD_FAT_PARTITION_NAME = "primary"
SDCARD_ROOTFS_PARTITION_NAME = "primary"

BASE_IMAGE_ROOTFS_ALIGNMENT ?= "4096"
IMAGE_ROOTFS_ALIGNMENT ?= "4096"
```

## meta-alb-bsp/conf/machine/include/s32g-cdma.inc
```bitbake
# Copyright 2026 NXP

DEFAULT_DT := "${KERNEL_DEVICETREE}"
CDMA_DT := "${@d.getVar('KERNEL_DEVICETREE', True).replace('.${FLASHIMAGE_DTB_SUFFIX}', '-cdma-pipe10.${FLASHIMAGE_DTB_SUFFIX}')}"
KERNEL_DEVICETREE ?= "${@bb.utils.contains('DISTRO_FEATURES', 'pcie-services-demos', '${CDMA_DT}', '${DEFAULT_DT}', d)}"
FLASHIMAGE_DTB_FILE = "${@d.getVar('KERNEL_DEVICETREE').replace('freescale/', '')}"
```
