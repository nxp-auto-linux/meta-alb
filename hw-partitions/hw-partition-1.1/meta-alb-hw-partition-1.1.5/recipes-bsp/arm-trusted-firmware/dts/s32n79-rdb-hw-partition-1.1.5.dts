// SPDX-License-Identifier: (GPL-2.0+ OR BSD-3-Clause)
/*
 * Copyright 2025-2026 NXP
 */

/dts-v1/;

#include "s32n79-rdb.dtsi"
#include "s32n79-hw-partition-1.1.5.dtsi"

/ {
	model = "NXP S32N79-RDB";
};
