// SPDX-License-Identifier: (GPL-2.0+ OR BSD-3-Clause)
/*
 * Copyright 2026 NXP
 */

/ {
	memory@9c000000 {
		device_type = "memory";
		reg = <0x0 0x9c000000 0 0x1c000000>; /* 448MB */
	};

	ddr_high0: memory@89c0000000 {
		device_type = "memory";
		reg = <0x89 0xc0000000 0x2 0x00000000>; /* 8GB */
		status = "disabled";
	};

	ddr_high1: memory@c1c0000000 {
		device_type = "memory";
		reg = <0xc1 0xc0000000 0x2 0x00000000>; /* 8GB */
		status = "disabled";
	};
};
