## meta-alb-bsp/conf/machine/include/s32n-sim-base.inc
```bitbake
require conf/machine/include/s32-sim-base.inc
require conf/machine/include/s32n-base.inc

SDCARD_SIMIMAGE ?= "${DEPLOY_DIR_IMAGE}/simimage/${IMAGE_BASENAME}.sdcard"
UFS_LUN0_SIMIMAGE ?= "${DEPLOY_DIR_IMAGE}/simimage/${IMAGE_BASENAME}.lun0.ufs"
UFS_LUN1_SIMIMAGE ?= "${DEPLOY_DIR_IMAGE}/simimage/${IMAGE_BASENAME}.lun1.ufs"
```

## meta-alb-bsp/conf/machine/s32g399abase.conf
```bitbake
#@TYPE: Machine
#@NAME: NXP S32G399ABASE
#@SOC: s32g399a
#@DESCRIPTION: Machine configuration for running the S32G399ABASE in 64-bit mode
#@MAINTAINER: Catalin Dan Udma <catalin-dan.udma@nxp.com>
# Copyright 2024 NXP

require conf/machine/include/s32g3.inc

TFA_PLAT = "s32g399abase"

UBOOT_DEFCONFIG = "s32g399abase_defconfig"
UBOOT_FLASH_DEFCONFIG = "s32g399abase_qspi_defconfig"

KERNEL_DEVICETREE ??= "freescale/s32g399a-vc-base.dtb"
FLASHIMAGE_DTB_FILE = "s32g399a-vc-base.${FLASHIMAGE_DTB_SUFFIX}"

require ${@bb.utils.contains('DISTRO_FEATURES', 'pfe-slave', 'conf/machine/include/s32g-pfems.inc', '', d)}
```

## meta-alb-bsp/conf/machine/s32g399asom.conf
```bitbake
#@TYPE: Machine
#@NAME: NXP S32G399ASOM
#@SOC: s32g399a
#@DESCRIPTION: Machine configuration for running the S32G399ASOM in 64-bit mode
#@MAINTAINER: Catalin Dan Udma <catalin-dan.udma@nxp.com>
# Copyright 2024 NXP

require conf/machine/include/s32g3.inc

TFA_PLAT = "s32g399asom"

UBOOT_DEFCONFIG = "s32g399asom_defconfig"
UBOOT_FLASH_DEFCONFIG = "s32g399asom_qspi_defconfig"

KERNEL_DEVICETREE ??= "freescale/s32g399a-vc-som.dtb"
FLASHIMAGE_DTB_FILE = "s32g399a-vc-som.${FLASHIMAGE_DTB_SUFFIX}"

require ${@bb.utils.contains('DISTRO_FEATURES', 'pfe-slave', 'conf/machine/include/s32g-pfems.inc', '', d)}
```

## meta-alb-bsp/conf/machine/s32n79sim.conf
```bitbake
#@TYPE: Machine
#@NAME: NXP S32N79 SIMULATOR
#@SOC: s32n79
#@DESCRIPTION: Machine configuration for running the S32N SIMULATOR in 64-bit mode
#@MAINTAINER: Radu Daia <radu.daia@nxp.com>
# Copyright 2024-2025 NXP

require conf/machine/include/s32n-sim-base.inc

SOC_FAMILY:append = ":s32n7sim"
MACHINEOVERRIDES =. "s32n7sim:"

KERNEL_DEVICETREE ?= "freescale/s32n79-simulator.dtb"
TFA_PLAT = "s32n79sim"

UBOOT_DEFCONFIG = "s32n79sim_defconfig"
UBOOT_MMC_DEFCONFIG = "s32n79sim_mmc_defconfig"
UBOOT_CONFIG ?= "ufs sdcard"
UBOOT_CONFIG[ufs] = "${UBOOT_DEFCONFIG},,u-boot-nodtb.${UBOOT_SUFFIX}"
UBOOT_CONFIG[sdcard] = "${UBOOT_MMC_DEFCONFIG},,u-boot-nodtb.${UBOOT_SUFFIX}"

IMAGE_FSTYPES += "cpio.gz.u-boot ext4"
SERIAL_CONSOLES ?= "115200;ttyAMA0"
SERIAL_CONSOLES_CHECK ?= "ttyAMA0:ttyAMA0 ttyAMA1:ttyAMA1 ttyAMA2:ttyAMA2 " \
                         "ttyAMA3:ttyAMA3 ttyAMA4:ttyAMA4 ttyAMA5:ttyAMA5 " \
			 "ttyAMA6:ttyAMA6 ttyAMA7:ttyAMA7"

EXTRA_IMAGECMD:ext4 = "-i 4096 -b 4096 -L ${IMAGE_NAME}"
```

## meta-alb-bsp/recipes-bsp/arm-trusted-firmware/arm-trusted-firmware/s32.its
```
/* Copyright 2023,2025 NXP */

/dts-v1/;
/ {
    description = "kernel+dtb/fdt fit image";
    #address-cells = <1>;
    images {
            kernel-1 {
                description = "kernel image";
                data = /incbin/("<kernel_image>");
                type = "kernel";
                arch = "arm64";
                os = "linux";
                compression = "none";
                load = <0x93000000>;
                entry = <0x93000000>;
                kernel-version = <1>;
                hash-1 {
                    algo = "sha1";
                };
            };
            fdt-1 {
                description = "dtb blob";
                data = /incbin/("<dtb_blob>");
                type = "flat_dt";
                arch = "arm64";
                compression = "none";
                load = <0x96000000>;
                fdt-version = <1>;
                hash-1 {
                    algo = "sha1";
                };
            };
    };
    configurations {
        default = "conf-1";
            conf-1 {
                kernel = "kernel-1";
                fdt = "fdt-1";
                signature-1 {
                    algo = "sha1,rsa2048";
                    key-name-hint = "boot_key";
                    sign-images = "kernel", "fdt";
                };
            };
    };
};
```

## meta-alb-qoriq/conf/machine/include/qoriq-atf.inc
```bitbake
# Copyright 2023-2024 NXP

TFA = "qoriq-atf"
TFA_RESET_FILE_NOR = "atf/bl2_nor.pbl"
TFA_IMAGE_FILE_NOR = "atf/fip_uboot.bin"
TFA_RESET_FILE_SD = "atf/bl2_sd.pbl"
TFA_IMAGE_FILE_SD = "atf/fip_uboot.bin"
TFA_RESET_FILE_XSPI = "atf/bl2_flexspi_nor.pbl"
TFA_IMAGE_FILE_XSPI = "atf/fip_uboot.bin"
TFA_RESET_FILE_QSPI = "atf/bl2_qspi.pbl"
TFA_IMAGE_FILE_QSPI = "atf/fip_uboot.bin"
```
